// SPDX-License-Identifier: GPL-2.0+ OR MIT
/* Dedicated APR apertures and DART from the Neo's live 25G76 ADT. */
/ {
	soc {
		apr_dart: iommu@295020000 {
			compatible = "apple,t8140-dart", "apple,t8110-dart";
			reg = <0x2 0x95020000 0 0x20000>;
			interrupt-parent = <&aic>;
			interrupts = <AIC_IRQ 1257 IRQ_TYPE_LEVEL_HIGH>;
			power-domains = <&ps_prores>;
			#iommu-cells = <1>;
			apple,dma-range = <0x100 0x4000 0 0x0fffc000>;
		};
		apr: video-codec@295000000 {
			compatible = "apple,t8140-prores-test";
			reg = <0x2 0x95000000 0 0x4000>, <0x2 0x94000000 0 0x8000>;
			interrupt-parent = <&aic>;
			interrupts = <AIC_IRQ 1260 IRQ_TYPE_LEVEL_HIGH>,
				     <AIC_IRQ 1259 IRQ_TYPE_LEVEL_HIGH>;
			power-domains = <&ps_prores>;
			iommus = <&apr_dart 0>;
		};
	};
};
