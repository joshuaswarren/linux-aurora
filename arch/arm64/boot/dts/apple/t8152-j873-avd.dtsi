// SPDX-License-Identifier: GPL-2.0+ OR MIT
/* J873g ADT: Kopsia AVD, PSD service 50, Gen3 DART SIDs 0..2. */
&{/soc} {
	ps_avd: power-controller@303a13200 {
		compatible = "apple,t8152-avd-psd";
		reg = <0x3 0x03a13200 0 0x100>;
		#power-domain-cells = <0>;
	};

	avd: video-codec@485400000 {
		compatible = "apple,t8152-avd";
		power-domains = <&ps_avd>;
		reg = <0x4 0x85400000 0 0x12000>,
		      <0x4 0x85500000 0 0x4000>,
		      <0x4 0x85100000 0 0x10000>,
		      <0x4 0x850c0000 0 0x4000>,
		      <0x4 0x85070000 0 0x4000>;
		reg-names = "code", "mbox", "ctrl", "wrap", "dma";
		iommus = <&avd_dart 0>, <&avd_dart 1>, <&avd_dart 2>;
	};
};

&avd_dart {
	compatible = "apple,t8152-avd-dart";
	reg = <0x4 0x85020000 0 0x20000>, <0x2 0x300 0 0x10>;
	reg-names = "dart", "tlbi";
	power-domains = <&ps_avd>;
	/* A 64-GiB window within the ADT's 1..4-TiB DMA aperture. */
	apple,dma-range = <0x100 0 0x10 0>;
	apple,tunable = <
		0x20c 0x80000121 0x80000121
		0x220 0xf0f 0xf0f
		0x224 0xffff 0x909
		0x300 0x1f31 0x1
		0x308 0x3ffffffc 0x10000000
		0x310 0x3ffffffc 0x3ffffffc
		0x800 0xf007f 0x10000
		0x804 0xf007f 0x20002
		0x808 0xf007f 0x50006
		0x80c 0xf007f 0x20026
		0x810 0xf007f 0x3002a
		0x814 0xf007f 0x40032
		0x818 0xf007f 0x0
		0x81c 0xf007f 0x0
		0x820 0xf007f 0x0
		0x824 0xf007f 0x0
		0x828 0xf007f 0x0
		0x82c 0xf007f 0x0
		0x830 0xf007f 0x0
		0x834 0xf007f 0x0
		0x838 0xf007f 0x0
		0x83c 0xf007f 0x0
		0x4600 0x2 0x2
	>;
	status = "okay";
};
