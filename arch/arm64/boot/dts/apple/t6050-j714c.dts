// SPDX-License-Identifier: GPL-2.0+ OR MIT
/*
 * Apple MacBook Pro (14-inch, M5 Max, 2026)
 *
 * target-type: J714c
 *
 * Copyright The Asahi Linux Contributors
 */

/dts-v1/;

#include "t6050.dtsi"
#include "t6050-j714-j716.dtsi"

/ {
	compatible = "apple,j714c", "apple,t6050", "apple,arm-platform";
	model = "Apple MacBook Pro (14-inch, M5 Max, 2026)";
};
