// SPDX-License-Identifier: GPL-2.0+ OR MIT
/* Opt-in media diagnostic DT. Run AVE boot preflight before using this DT!
 * The union loader aborts before Linux if AVE reservations cannot be made.
 * The ordinary t8140-j700.dtb deliberately has no AVE node.
 */
#include "t8140-j700.dts"
#include "t8140-ave.dtsi"
