// SPDX-License-Identifier: GPL-2.0+ OR MIT
/*
 * J700 PMP-v2 own-device metadata, generated from this machine's ADT by
 * neo-bringup/tools/gen-j700-pmp-dtsi.py (do not edit by hand).
 *
 * Source ADT: iBoot mBoot-18000.161.10, /arm-io/pmp/iop-pmp-nub uuid 84A026DE-8896-3CF4-A5B5-367879C8FBEE
 * (the T8140 PMP firmware of macOS 26.6.2 build 25G83).
 *
 * This is exactly what the aurora-silicon/m1n1-cleanroom bootloader forwards
 * at boot (dt_set_j700_pmp_v2/dt_set_j700_pmp_apf); the Aurora stage-2 m1n1
 * does not, so the board DTS carries it.  Values are raw little-endian ADT
 * property bytes; see the script for the derivation of each property.
 */

&pmp {
	status = "okay";
	apple,metadata-version = <1>;
	/* BDID, DVID, DCAP, DCHD, PMC_, PMCV, PMCB, PMCX, CVAR, PMCM */
	apple,patchbay-values = <0x42444944 100 0x44564944 6 0x44434150 0 0x44434844 0 0x504d435f 1 0x504d4356 1 0x504d4342 1 0x504d4358 0 0x43564152 0 0x504d434d 1000000>;
	/* iop-pmp-nub segment-ranges: physical, virtual, device (u64), size, flags (u32) */
	apple,resident-segments = [
		00 00 50 00 03 00 00 00 00 00 00 01 00 00 00 00
		00 00 50 00 03 00 00 00 00 c0 03 00 03 00 00 00
		00 c0 53 00 03 00 00 00 00 c0 03 01 00 00 00 00
		00 c0 53 00 03 00 00 00 00 c0 05 00 06 00 00 00
	];
	apple,dma-range = <0x100 0x00000000 0x0 0xbff00000>;
	/* dart-pmp instance, dapf-instance-0 and dart-tunables-instance-0 */
	apple,apf-instance = [
		54 52 41 44 00 00 00 00 44 41 52 54 00 00 00 00
		46 50 41 44 00 00 00 00 44 41 52 54 00 00 00 00
		46 50 41 47 00 00 00 00 50 53 5f 50 52 4f 54 00
	];
	apple,apf-capacity = <32>;
	apple,apf-table = [
		00 00 02 20 02 00 00 00 00 00 03 20 02 00 00 00
		01 00 00 00 00 00 00 00 00 00 00 00 00 00 00 00
		00 00 00 00 00 00 00 00 00 00 00 00 00 00 00 00
		00 03 01 00 00 00 06 20 02 00 00 00 00 00 07 20
		02 00 00 00 01 00 00 00 00 00 00 00 00 00 00 00
		00 00 00 00 00 00 00 00 00 00 00 00 00 00 00 00
		00 00 00 00 00 03 01 00 00 00 0a 20 02 00 00 00
		00 00 0b 20 02 00 00 00 01 00 00 00 00 00 00 00
		00 00 00 00 00 00 00 00 00 00 00 00 00 00 00 00
		00 00 00 00 00 00 00 00 00 03 01 00 00 00 0e 20
		02 00 00 00 00 00 0f 20 02 00 00 00 01 00 00 00
		00 00 00 00 00 00 00 00 00 00 00 00 00 00 00 00
		00 00 00 00 00 00 00 00 00 00 00 00 00 03 01 00
		00 40 40 20 02 00 00 00 70 40 40 20 02 00 00 00
		01 00 00 00 00 00 00 00 00 00 00 00 00 00 00 00
		00 00 00 00 00 00 00 00 00 00 00 00 00 00 00 00
		00 03 01 00 00 40 60 20 02 00 00 00 70 40 60 20
		02 00 00 00 01 00 00 00 00 00 00 00 00 00 00 00
		00 00 00 00 00 00 00 00 00 00 00 00 00 00 00 00
		00 00 00 00 00 03 01 00 00 40 80 20 02 00 00 00
		70 40 80 20 02 00 00 00 01 00 00 00 00 00 00 00
		00 00 00 00 00 00 00 00 00 00 00 00 00 00 00 00
		00 00 00 00 00 00 00 00 00 03 01 00 00 d0 19 08
		03 00 00 00 0c d0 19 08 03 00 00 00 04 00 00 00
		00 00 00 00 00 00 00 00 00 00 00 00 00 00 00 00
		00 00 00 00 00 00 00 00 00 00 00 00 01 03 01 00
		00 00 e4 10 02 00 00 00 ff ff e7 10 02 00 00 00
		01 00 00 00 00 00 00 00 00 00 00 00 00 00 00 00
		00 00 00 00 00 00 00 00 00 00 00 00 00 00 00 00
		00 03 01 00 00 00 e4 11 02 00 00 00 ff ff e7 11
		02 00 00 00 01 00 00 00 00 00 00 00 00 00 00 00
		00 00 00 00 00 00 00 00 00 00 00 00 00 00 00 00
		00 00 00 00 00 03 01 00 00 c0 96 01 04 00 00 00
		ff bf 97 01 04 00 00 00 01 00 00 00 00 00 00 00
		00 00 00 00 00 00 00 00 00 00 00 00 00 00 00 00
		00 00 00 00 00 00 00 00 00 03 01 00 00 40 d1 80
		04 00 00 00 ff 3f e2 80 04 00 00 00 01 00 00 00
		00 00 00 00 00 00 00 00 00 00 00 00 00 00 00 00
		00 00 00 00 00 00 00 00 00 00 00 00 00 03 01 00
		00 80 e7 10 02 00 00 00 00 00 ef 10 02 00 00 00
		01 00 00 00 00 00 00 00 00 00 00 00 00 00 00 00
		00 00 00 00 00 00 00 00 00 00 00 00 00 00 00 00
		00 03 01 00 00 80 e7 11 02 00 00 00 00 00 ef 11
		02 00 00 00 01 00 00 00 00 00 00 00 00 00 00 00
		00 00 00 00 00 00 00 00 00 00 00 00 00 00 00 00
		00 00 00 00 00 03 01 00 00 80 86 01 04 00 00 00
		08 df 86 01 04 00 00 00 01 00 00 00 00 00 00 00
		00 00 00 00 00 00 00 00 00 00 00 00 00 00 00 00
		00 00 00 00 00 00 00 00 00 03 01 00 00 40 00 4f
		02 00 00 00 84 40 00 4f 02 00 00 00 01 00 00 00
		00 00 00 00 00 00 00 00 00 00 00 00 00 00 00 00
		00 00 00 00 00 00 00 00 00 00 00 00 00 03 01 00
		00 80 00 4f 02 00 00 00 40 c1 00 4f 02 00 00 00
		01 00 00 00 00 00 00 00 00 00 00 00 00 00 00 00
		00 00 00 00 00 00 00 00 00 00 00 00 00 00 00 00
		00 03 01 00 00 40 00 50 02 00 00 00 84 40 00 50
		02 00 00 00 01 00 00 00 00 00 00 00 00 00 00 00
		00 00 00 00 00 00 00 00 00 00 00 00 00 00 00 00
		00 00 00 00 00 03 01 00 00 80 00 50 02 00 00 00
		40 c1 00 50 02 00 00 00 01 00 00 00 00 00 00 00
		00 00 00 00 00 00 00 00 00 00 00 00 00 00 00 00
		00 00 00 00 00 00 00 00 00 03 01 00 00 40 00 51
		02 00 00 00 84 40 00 51 02 00 00 00 01 00 00 00
		00 00 00 00 00 00 00 00 00 00 00 00 00 00 00 00
		00 00 00 00 00 00 00 00 00 00 00 00 00 03 01 00
		00 80 00 51 02 00 00 00 40 c1 00 51 02 00 00 00
		01 00 00 00 00 00 00 00 00 00 00 00 00 00 00 00
		00 00 00 00 00 00 00 00 00 00 00 00 00 00 00 00
		00 03 01 00 00 c0 01 20 02 00 00 00 00 e0 01 20
		02 00 00 00 01 00 00 00 00 00 00 00 00 00 00 00
		00 00 00 00 00 00 00 00 00 00 00 00 00 00 00 00
		00 00 00 00 00 03 01 00 00 c0 05 20 02 00 00 00
		00 e0 05 20 02 00 00 00 01 00 00 00 00 00 00 00
		00 00 00 00 00 00 00 00 00 00 00 00 00 00 00 00
		00 00 00 00 00 00 00 00 00 03 01 00 00 c0 09 20
		02 00 00 00 00 e0 09 20 02 00 00 00 01 00 00 00
		00 00 00 00 00 00 00 00 00 00 00 00 00 00 00 00
		00 00 00 00 00 00 00 00 00 00 00 00 00 03 01 00
		00 c0 0d 20 02 00 00 00 00 e0 0d 20 02 00 00 00
		01 00 00 00 00 00 00 00 00 00 00 00 00 00 00 00
		00 00 00 00 00 00 00 00 00 00 00 00 00 00 00 00
		00 03 01 00 00 80 2c 08 03 00 00 00 50 80 2c 08
		03 00 00 00 01 00 00 00 00 00 00 00 00 00 00 00
		00 00 00 00 00 00 00 00 00 00 00 00 00 00 00 00
		00 00 00 00 00 03 01 00 00 40 10 20 02 00 00 00
		00 c0 11 20 02 00 00 00 01 00 00 00 00 00 00 00
		00 00 00 00 00 00 00 00 00 00 00 00 00 00 00 00
		00 00 00 00 00 00 00 00 00 03 01 00
	];
	apple,dart-tunables = [
		0c 02 00 00 04 00 00 00 21 05 00 80 00 00 00 00
		21 05 00 80 00 00 00 00 20 02 00 00 04 00 00 00
		0f 0f 0f 00 00 00 00 00 0f 0f 0f 00 00 00 00 00
		24 02 00 00 04 00 00 00 ff ff ff 00 00 00 00 00
		08 08 08 00 00 00 00 00 00 03 00 00 04 00 00 00
		31 1f 00 00 00 00 00 00 01 00 00 00 00 00 00 00
		08 03 00 00 04 00 00 00 fc ff ff 3f 00 00 00 00
		00 00 00 10 00 00 00 00 10 03 00 00 04 00 00 00
		fc ff ff 3f 00 00 00 00 fc ff ff 3f 00 00 00 00
		18 03 00 00 04 00 00 00 31 1f 00 00 00 00 00 00
		01 00 00 00 00 00 00 00 20 03 00 00 04 00 00 00
		fc ff ff 3f 00 00 00 00 00 00 f0 0f 00 00 00 00
		28 03 00 00 04 00 00 00 fc ff ff 3f 00 00 00 00
		fc 17 f0 0f 00 00 00 00
	];

	/* Exact iop-pmp-nub property bytes: boot classification and registry defaults. */
	firmware-data {
		agx-af-wr-bw-threshold = [
			00 00 00 00 00 00 00 00 00 00 00 00 00 00 00 00
			00 00 00 00 00 00 00 00 00 00 00 00 05 00 00 00
			00 00 00 00 00 00 00 00 00 00 00 00 05 00 00 00
			00 00 00 00 00 00 00 00 00 00 00 00 05 00 00 00
			00 00 31 00 00 00 00 00 00 00 00 00 00 00 00 00
			00 00 41 00 00 00 00 00 00 00 30 00 05 00 00 00
			00 00 62 00 00 00 00 00 00 00 40 00 05 00 00 00
			00 00 00 00 00 00 00 00 00 00 61 00 05 00 00 00
			00 00 2a 00 00 00 00 00 00 00 00 00 00 00 00 00
			00 00 3e 00 00 00 00 00 00 00 29 00 05 00 00 00
			00 00 48 00 00 00 00 00 00 00 3d 00 05 00 00 00
			00 00 00 00 00 00 00 00 00 00 47 00 05 00 00 00
			00 00 16 00 00 00 00 00 00 00 00 00 00 00 00 00
			00 00 38 00 00 00 00 00 00 00 15 00 05 00 00 00
			00 00 48 00 00 00 00 00 00 00 37 00 05 00 00 00
			00 00 00 00 00 00 00 00 00 00 47 00 05 00 00 00
			00 00 08 00 00 00 00 00 00 00 00 00 00 00 00 00
			00 00 2c 00 00 00 00 00 00 00 07 00 05 00 00 00
			00 00 48 00 00 00 00 00 00 00 2b 00 05 00 00 00
			00 00 00 00 00 00 00 00 00 00 47 00 05 00 00 00
			00 00 02 00 00 00 00 00 00 00 00 00 00 00 00 00
			00 00 20 00 00 00 00 00 00 00 01 00 05 00 00 00
			00 00 39 00 00 00 00 00 00 00 1f 00 05 00 00 00
			00 00 00 00 00 00 00 00 00 00 38 00 05 00 00 00
			00 00 02 00 00 00 00 00 00 00 00 00 00 00 00 00
			00 00 0a 00 00 00 00 00 00 00 01 00 05 00 00 00
			00 00 32 00 00 00 00 00 00 00 09 00 05 00 00 00
			00 00 00 00 00 00 00 00 00 00 31 00 05 00 00 00
			00 00 02 00 00 00 00 00 00 00 00 00 00 00 00 00
			00 00 07 00 00 00 00 00 00 00 01 00 05 00 00 00
			00 00 2c 00 00 00 00 00 00 00 06 00 05 00 00 00
			00 00 00 00 00 00 00 00 00 00 2b 00 05 00 00 00
			00 00 02 00 00 00 00 00 00 00 00 00 00 00 00 00
			00 00 07 00 00 00 00 00 00 00 01 00 05 00 00 00
			00 00 11 00 00 00 00 00 00 00 06 00 05 00 00 00
			00 00 00 00 00 00 00 00 00 00 10 00 05 00 00 00
			00 00 02 00 00 00 00 00 00 00 00 00 00 00 00 00
			00 00 07 00 00 00 00 00 00 00 01 00 05 00 00 00
			00 00 11 00 00 00 00 00 00 00 06 00 05 00 00 00
			00 00 00 00 00 00 00 00 00 00 10 00 05 00 00 00
			00 00 02 00 00 00 00 00 00 00 00 00 00 00 00 00
			00 00 07 00 00 00 00 00 00 00 01 00 05 00 00 00
			00 00 11 00 00 00 00 00 00 00 06 00 05 00 00 00
			00 00 00 00 00 00 00 00 00 00 10 00 05 00 00 00
		];
		mc_quota_req_ptd_count = [08 00 00 00];
		mc_cmd_ptd_count = [02 00 00 00];
		ane-dcs-bw-dvfs-filter = [ff ff 0f 00];
		mc-cue-win-count = [01 00 00 00];
		sochot-sensors = [
			01 00 00 00 02 00 00 00 03 00 00 00 04 00 00 00
			05 00 00 00
		];
		agx-af-rd-bw-threshold = [
			00 00 00 00 00 00 00 00 00 00 00 00 00 00 00 00
			00 00 00 00 00 00 00 00 00 00 00 00 05 00 00 00
			00 00 00 00 00 00 00 00 00 00 00 00 05 00 00 00
			00 00 00 00 00 00 00 00 00 00 00 00 05 00 00 00
			00 00 31 00 00 00 00 00 00 00 00 00 00 00 00 00
			00 00 41 00 00 00 00 00 00 00 30 00 05 00 00 00
			00 00 62 00 00 00 00 00 00 00 40 00 05 00 00 00
			00 00 00 00 00 00 00 00 00 00 61 00 05 00 00 00
			00 00 2a 00 00 00 00 00 00 00 00 00 00 00 00 00
			00 00 3e 00 00 00 00 00 00 00 29 00 05 00 00 00
			00 00 48 00 00 00 00 00 00 00 3d 00 05 00 00 00
			00 00 00 00 00 00 00 00 00 00 47 00 05 00 00 00
			00 00 16 00 00 00 00 00 00 00 00 00 00 00 00 00
			00 00 38 00 00 00 00 00 00 00 15 00 05 00 00 00
			00 00 48 00 00 00 00 00 00 00 37 00 05 00 00 00
			00 00 00 00 00 00 00 00 00 00 47 00 05 00 00 00
			00 00 08 00 00 00 00 00 00 00 00 00 00 00 00 00
			00 00 2c 00 00 00 00 00 00 00 07 00 05 00 00 00
			00 00 48 00 00 00 00 00 00 00 2b 00 05 00 00 00
			00 00 00 00 00 00 00 00 00 00 47 00 05 00 00 00
			00 00 02 00 00 00 00 00 00 00 00 00 00 00 00 00
			00 00 20 00 00 00 00 00 00 00 01 00 05 00 00 00
			00 00 39 00 00 00 00 00 00 00 1f 00 05 00 00 00
			00 00 00 00 00 00 00 00 00 00 38 00 05 00 00 00
			00 00 02 00 00 00 00 00 00 00 00 00 00 00 00 00
			00 00 0a 00 00 00 00 00 00 00 01 00 05 00 00 00
			00 00 32 00 00 00 00 00 00 00 09 00 05 00 00 00
			00 00 00 00 00 00 00 00 00 00 31 00 05 00 00 00
			00 00 02 00 00 00 00 00 00 00 00 00 00 00 00 00
			00 00 07 00 00 00 00 00 00 00 01 00 05 00 00 00
			00 00 2c 00 00 00 00 00 00 00 06 00 05 00 00 00
			00 00 00 00 00 00 00 00 00 00 2b 00 05 00 00 00
			00 00 02 00 00 00 00 00 00 00 00 00 00 00 00 00
			00 00 07 00 00 00 00 00 00 00 01 00 05 00 00 00
			00 00 11 00 00 00 00 00 00 00 06 00 05 00 00 00
			00 00 00 00 00 00 00 00 00 00 10 00 05 00 00 00
			00 00 02 00 00 00 00 00 00 00 00 00 00 00 00 00
			00 00 07 00 00 00 00 00 00 00 01 00 05 00 00 00
			00 00 11 00 00 00 00 00 00 00 06 00 05 00 00 00
			00 00 00 00 00 00 00 00 00 00 10 00 05 00 00 00
			00 00 02 00 00 00 00 00 00 00 00 00 00 00 00 00
			00 00 07 00 00 00 00 00 00 00 01 00 05 00 00 00
			00 00 11 00 00 00 00 00 00 00 06 00 05 00 00 00
			00 00 00 00 00 00 00 00 00 00 10 00 05 00 00 00
		];
		ane-af-bw-dvfs-filter = [ff ff 0f 00];
		agx-dcs-lat-threshold = [
			20 00 00 00 03 00 00 00 10 00 00 00 00 00 00 00
			90 01 00 00 00 00 00 00 c8 00 00 00 03 00 00 00
			20 00 00 00 03 00 00 00 10 00 00 00 00 00 00 00
			90 01 00 00 00 00 00 00 c8 00 00 00 03 00 00 00
			20 00 00 00 03 00 00 00 10 00 00 00 00 00 00 00
			90 01 00 00 00 00 00 00 c8 00 00 00 03 00 00 00
			20 00 00 00 03 00 00 00 10 00 00 00 00 00 00 00
			90 01 00 00 00 00 00 00 c8 00 00 00 03 00 00 00
			20 00 00 00 03 00 00 00 10 00 00 00 00 00 00 00
			90 01 00 00 00 00 00 00 c8 00 00 00 03 00 00 00
			20 00 00 00 03 00 00 00 10 00 00 00 00 00 00 00
			90 01 00 00 00 00 00 00 c8 00 00 00 03 00 00 00
			20 00 00 00 03 00 00 00 10 00 00 00 00 00 00 00
			90 01 00 00 00 00 00 00 c8 00 00 00 03 00 00 00
			20 00 00 00 03 00 00 00 10 00 00 00 00 00 00 00
			90 01 00 00 00 00 00 00 c8 00 00 00 03 00 00 00
			20 00 00 00 03 00 00 00 10 00 00 00 00 00 00 00
			90 01 00 00 00 00 00 00 c8 00 00 00 03 00 00 00
			20 00 00 00 03 00 00 00 10 00 00 00 00 00 00 00
			90 01 00 00 00 00 00 00 c8 00 00 00 03 00 00 00
			20 00 00 00 03 00 00 00 10 00 00 00 00 00 00 00
			90 01 00 00 00 00 00 00 c8 00 00 00 03 00 00 00
			20 00 00 00 03 00 00 00 10 00 00 00 00 00 00 00
			90 01 00 00 00 00 00 00 c8 00 00 00 03 00 00 00
			20 00 00 00 03 00 00 00 10 00 00 00 00 00 00 00
			90 01 00 00 00 00 00 00 c8 00 00 00 03 00 00 00
			20 00 00 00 03 00 00 00 10 00 00 00 00 00 00 00
			90 01 00 00 00 00 00 00 c8 00 00 00 03 00 00 00
			20 00 00 00 03 00 00 00 10 00 00 00 00 00 00 00
			90 01 00 00 00 00 00 00 c8 00 00 00 03 00 00 00
			20 00 00 00 03 00 00 00 10 00 00 00 00 00 00 00
			90 01 00 00 00 00 00 00 c8 00 00 00 03 00 00 00
			20 00 00 00 03 00 00 00 10 00 00 00 00 00 00 00
			90 01 00 00 00 00 00 00 c8 00 00 00 03 00 00 00
			20 00 00 00 03 00 00 00 10 00 00 00 00 00 00 00
			90 01 00 00 00 00 00 00 c8 00 00 00 03 00 00 00
			20 00 00 00 03 00 00 00 10 00 00 00 00 00 00 00
			90 01 00 00 00 00 00 00 c8 00 00 00 03 00 00 00
			20 00 00 00 03 00 00 00 10 00 00 00 00 00 00 00
			90 01 00 00 00 00 00 00 c8 00 00 00 03 00 00 00
			20 00 00 00 03 00 00 00 10 00 00 00 00 00 00 00
			90 01 00 00 00 00 00 00 c8 00 00 00 03 00 00 00
			20 00 00 00 03 00 00 00 10 00 00 00 00 00 00 00
			90 01 00 00 00 00 00 00 c8 00 00 00 03 00 00 00
			20 00 00 00 03 00 00 00 10 00 00 00 00 00 00 00
			90 01 00 00 00 00 00 00 c8 00 00 00 03 00 00 00
			20 00 00 00 03 00 00 00 10 00 00 00 00 00 00 00
			90 01 00 00 00 00 00 00 c8 00 00 00 03 00 00 00
			20 00 00 00 03 00 00 00 10 00 00 00 00 00 00 00
			90 01 00 00 00 00 00 00 c8 00 00 00 03 00 00 00
			20 00 00 00 03 00 00 00 10 00 00 00 00 00 00 00
			90 01 00 00 00 00 00 00 c8 00 00 00 03 00 00 00
			20 00 00 00 03 00 00 00 10 00 00 00 00 00 00 00
			90 01 00 00 00 00 00 00 c8 00 00 00 03 00 00 00
			20 00 00 00 03 00 00 00 10 00 00 00 00 00 00 00
			90 01 00 00 00 00 00 00 c8 00 00 00 03 00 00 00
			20 00 00 00 03 00 00 00 10 00 00 00 00 00 00 00
			90 01 00 00 00 00 00 00 c8 00 00 00 03 00 00 00
			20 00 00 00 03 00 00 00 10 00 00 00 00 00 00 00
			90 01 00 00 00 00 00 00 c8 00 00 00 03 00 00 00
			20 00 00 00 03 00 00 00 10 00 00 00 00 00 00 00
			90 01 00 00 00 00 00 00 c8 00 00 00 03 00 00 00
			20 00 00 00 03 00 00 00 10 00 00 00 00 00 00 00
			90 01 00 00 00 00 00 00 c8 00 00 00 03 00 00 00
			20 00 00 00 03 00 00 00 10 00 00 00 00 00 00 00
			90 01 00 00 00 00 00 00 c8 00 00 00 03 00 00 00
			20 00 00 00 03 00 00 00 10 00 00 00 00 00 00 00
			90 01 00 00 00 00 00 00 c8 00 00 00 03 00 00 00
			20 00 00 00 03 00 00 00 10 00 00 00 00 00 00 00
			90 01 00 00 00 00 00 00 c8 00 00 00 03 00 00 00
			20 00 00 00 03 00 00 00 10 00 00 00 00 00 00 00
			90 01 00 00 00 00 00 00 c8 00 00 00 03 00 00 00
			20 00 00 00 03 00 00 00 10 00 00 00 00 00 00 00
			90 01 00 00 00 00 00 00 c8 00 00 00 03 00 00 00
			20 00 00 00 03 00 00 00 10 00 00 00 00 00 00 00
			90 01 00 00 00 00 00 00 c8 00 00 00 03 00 00 00
			20 00 00 00 03 00 00 00 10 00 00 00 00 00 00 00
			90 01 00 00 00 00 00 00 c8 00 00 00 03 00 00 00
			20 00 00 00 03 00 00 00 10 00 00 00 00 00 00 00
			90 01 00 00 00 00 00 00 c8 00 00 00 03 00 00 00
			20 00 00 00 03 00 00 00 10 00 00 00 00 00 00 00
			90 01 00 00 00 00 00 00 c8 00 00 00 03 00 00 00
			20 00 00 00 03 00 00 00 10 00 00 00 00 00 00 00
			90 01 00 00 00 00 00 00 c8 00 00 00 03 00 00 00
			20 00 00 00 03 00 00 00 10 00 00 00 00 00 00 00
			90 01 00 00 00 00 00 00 c8 00 00 00 03 00 00 00
			20 00 00 00 03 00 00 00 10 00 00 00 00 00 00 00
			90 01 00 00 00 00 00 00 c8 00 00 00 03 00 00 00
			20 00 00 00 03 00 00 00 10 00 00 00 00 00 00 00
			90 01 00 00 00 00 00 00 c8 00 00 00 03 00 00 00
			20 00 00 00 03 00 00 00 10 00 00 00 00 00 00 00
			90 01 00 00 00 00 00 00 c8 00 00 00 03 00 00 00
			20 00 00 00 03 00 00 00 10 00 00 00 00 00 00 00
			90 01 00 00 00 00 00 00 c8 00 00 00 03 00 00 00
			20 00 00 00 03 00 00 00 10 00 00 00 00 00 00 00
			90 01 00 00 00 00 00 00 c8 00 00 00 03 00 00 00
			20 00 00 00 03 00 00 00 10 00 00 00 00 00 00 00
			90 01 00 00 00 00 00 00 c8 00 00 00 03 00 00 00
			20 00 00 00 03 00 00 00 10 00 00 00 00 00 00 00
			90 01 00 00 00 00 00 00 c8 00 00 00 03 00 00 00
			20 00 00 00 03 00 00 00 10 00 00 00 00 00 00 00
			90 01 00 00 00 00 00 00 c8 00 00 00 03 00 00 00
			20 00 00 00 03 00 00 00 10 00 00 00 00 00 00 00
			90 01 00 00 00 00 00 00 c8 00 00 00 03 00 00 00
			20 00 00 00 03 00 00 00 10 00 00 00 00 00 00 00
			90 01 00 00 00 00 00 00 c8 00 00 00 03 00 00 00
			20 00 00 00 03 00 00 00 10 00 00 00 00 00 00 00
			90 01 00 00 00 00 00 00 c8 00 00 00 03 00 00 00
			20 00 00 00 03 00 00 00 10 00 00 00 00 00 00 00
			90 01 00 00 00 00 00 00 c8 00 00 00 03 00 00 00
		];
		ptd-range = [
			01 00 00 00 00 00 00 00 01 00 00 00 00 00 00 00
			4e 55 4c 4c 00 00 00 00 00 00 00 00 00 00 00 00
			02 00 00 00 01 00 00 00 01 00 00 00 0b 00 00 00
			50 4d 50 2d 53 54 41 54 55 53 00 00 00 00 00 00
			03 00 00 00 08 00 00 00 04 00 00 00 00 00 00 00
			44 56 46 53 2d 53 54 41 54 45 00 00 00 00 00 00
			04 00 00 00 0c 00 00 00 04 00 00 00 00 00 00 00
			50 4d 50 54 4f 4f 4c 00 00 00 00 00 00 00 00 00
			05 00 00 00 10 00 00 00 10 00 00 00 00 00 00 00
			50 4d 53 2d 50 4d 47 52 2d 50 4b 54 00 00 00 00
			06 00 00 00 20 00 00 00 10 00 00 00 00 00 00 00
			50 4d 53 2d 44 50 45 2d 50 4b 54 00 00 00 00 00
			07 00 00 00 30 00 00 00 10 00 00 00 00 00 00 00
			50 4d 53 2d 44 45 56 43 2d 50 4b 54 00 00 00 00
			08 00 00 00 40 00 00 00 10 00 00 00 00 00 00 00
			50 4d 53 2d 43 31 50 50 54 2d 50 4b 54 00 00 00
			09 00 00 00 50 00 00 00 38 01 00 00 00 00 00 00
			53 4f 43 2d 44 45 56 2d 50 4b 54 00 00 00 00 00
			0a 00 00 00 88 01 00 00 04 00 00 00 00 00 00 00
			53 4f 43 2d 44 45 56 2d 50 53 2d 52 45 51 00 00
			0b 00 00 00 8c 01 00 00 04 00 00 00 00 00 00 00
			53 4f 43 2d 44 45 56 2d 50 53 2d 41 43 4b 00 00
			0c 00 00 00 90 01 00 00 10 00 00 00 00 00 00 00
			53 4f 43 2d 44 45 56 2d 44 56 46 53 00 00 00 00
			0d 00 00 00 a0 01 00 00 08 00 00 00 00 00 00 00
			4e 4f 54 2d 55 53 45 44 00 00 00 00 00 00 00 00
			0e 00 00 00 a8 01 00 00 0a 00 00 00 00 00 00 00
			4d 43 2d 44 52 56 2d 54 4f 2d 43 54 52 4c 00 00
			0f 00 00 00 b2 01 00 00 01 00 00 00 00 00 00 00
			41 56 44 2d 4e 52 47 00 00 00 00 00 00 00 00 00
			10 00 00 00 b3 01 00 00 01 00 00 00 00 00 00 00
			53 4f 43 2d 41 4f 4e 2d 4e 52 47 00 00 00 00 00
			11 00 00 00 b4 01 00 00 01 00 00 00 00 00 00 00
			53 4f 43 2d 52 45 53 54 2d 4e 52 47 00 00 00 00
			1e 00 00 00 b8 01 00 00 09 00 00 00 00 00 00 00
			4d 43 2d 43 54 52 4c 2d 54 4f 2d 44 52 56 00 00
			1f 00 00 00 c1 01 00 00 02 00 00 00 0c 00 00 00
			46 41 53 54 2d 44 49 45 2d 43 45 00 00 00 00 00
			20 00 00 00 c3 01 00 00 07 00 00 00 0d 00 00 00
			53 4d 43 2d 54 4f 2d 50 50 4d 00 00 00 00 00 00
			21 00 00 00 ca 01 00 00 01 00 00 00 00 00 00 00
			50 4d 55 2d 54 4f 2d 43 4c 50 43 00 00 00 00 00
			22 00 00 00 cb 01 00 00 01 00 00 00 0c 00 00 00
			4c 54 53 2d 56 4f 4c 54 2d 43 41 50 00 00 00 00
			40 00 00 00 cc 01 00 00 05 00 00 00 0e 00 00 00
			50 50 4d 2d 54 4f 2d 53 4d 43 00 00 00 00 00 00
			41 00 00 00 d1 01 00 00 05 00 00 00 0f 00 00 00
			43 4c 50 43 2d 54 4f 2d 53 4d 43 00 00 00 00 00
			42 00 00 00 d6 01 00 00 08 00 00 00 00 00 00 00
			47 46 58 2d 54 4f 2d 53 4d 43 00 00 00 00 00 00
			43 00 00 00 de 01 00 00 02 00 00 00 00 00 00 00
			46 41 53 54 2d 44 49 45 2d 54 4f 2d 53 4d 43 00
			44 00 00 00 e0 01 00 00 01 00 00 00 00 00 00 00
			4d 43 2d 43 54 52 4c 2d 54 4f 2d 53 4d 43 00 00
			45 00 00 00 e1 01 00 00 04 00 00 00 00 00 00 00
			50 50 4d 2d 54 4f 2d 53 4d 43 32 00 00 00 00 00
			46 00 00 00 e5 01 00 00 06 00 00 00 00 00 00 00
			41 4e 45 2d 54 4f 2d 53 4d 43 00 00 00 00 00 00
			52 00 00 00 ec 01 00 00 01 00 00 00 00 00 00 00
			4c 54 53 2d 54 4f 2d 47 46 58 00 00 00 00 00 00
			53 00 00 00 ed 01 00 00 01 00 00 00 00 00 00 00
			50 4d 55 2d 54 4f 2d 47 46 58 00 00 00 00 00 00
		];
		agx-af-lat-threshold = [
			20 00 00 00 03 00 00 00 10 00 00 00 00 00 00 00
			90 01 00 00 00 00 00 00 c8 00 00 00 03 00 00 00
			20 00 00 00 03 00 00 00 10 00 00 00 00 00 00 00
			90 01 00 00 00 00 00 00 c8 00 00 00 03 00 00 00
			20 00 00 00 03 00 00 00 10 00 00 00 00 00 00 00
			90 01 00 00 00 00 00 00 c8 00 00 00 03 00 00 00
			20 00 00 00 03 00 00 00 10 00 00 00 00 00 00 00
			90 01 00 00 00 00 00 00 c8 00 00 00 03 00 00 00
			20 00 00 00 03 00 00 00 10 00 00 00 00 00 00 00
			90 01 00 00 00 00 00 00 c8 00 00 00 03 00 00 00
			20 00 00 00 03 00 00 00 10 00 00 00 00 00 00 00
			90 01 00 00 00 00 00 00 c8 00 00 00 03 00 00 00
			20 00 00 00 03 00 00 00 10 00 00 00 00 00 00 00
			90 01 00 00 00 00 00 00 c8 00 00 00 03 00 00 00
			20 00 00 00 03 00 00 00 10 00 00 00 00 00 00 00
			90 01 00 00 00 00 00 00 c8 00 00 00 03 00 00 00
			20 00 00 00 03 00 00 00 10 00 00 00 00 00 00 00
			90 01 00 00 00 00 00 00 c8 00 00 00 03 00 00 00
			20 00 00 00 03 00 00 00 10 00 00 00 00 00 00 00
			90 01 00 00 00 00 00 00 c8 00 00 00 03 00 00 00
			20 00 00 00 03 00 00 00 10 00 00 00 00 00 00 00
			90 01 00 00 00 00 00 00 c8 00 00 00 03 00 00 00
			20 00 00 00 03 00 00 00 10 00 00 00 00 00 00 00
			90 01 00 00 00 00 00 00 c8 00 00 00 03 00 00 00
			20 00 00 00 03 00 00 00 10 00 00 00 00 00 00 00
			90 01 00 00 00 00 00 00 c8 00 00 00 03 00 00 00
			20 00 00 00 03 00 00 00 10 00 00 00 00 00 00 00
			90 01 00 00 00 00 00 00 c8 00 00 00 03 00 00 00
			20 00 00 00 03 00 00 00 10 00 00 00 00 00 00 00
			90 01 00 00 00 00 00 00 c8 00 00 00 03 00 00 00
			20 00 00 00 03 00 00 00 10 00 00 00 00 00 00 00
			90 01 00 00 00 00 00 00 c8 00 00 00 03 00 00 00
			20 00 00 00 03 00 00 00 10 00 00 00 00 00 00 00
			90 01 00 00 00 00 00 00 c8 00 00 00 03 00 00 00
			20 00 00 00 03 00 00 00 10 00 00 00 00 00 00 00
			90 01 00 00 00 00 00 00 c8 00 00 00 03 00 00 00
			20 00 00 00 03 00 00 00 10 00 00 00 00 00 00 00
			90 01 00 00 00 00 00 00 c8 00 00 00 03 00 00 00
			20 00 00 00 03 00 00 00 10 00 00 00 00 00 00 00
			90 01 00 00 00 00 00 00 c8 00 00 00 03 00 00 00
			20 00 00 00 03 00 00 00 10 00 00 00 00 00 00 00
			90 01 00 00 00 00 00 00 c8 00 00 00 03 00 00 00
			20 00 00 00 03 00 00 00 10 00 00 00 00 00 00 00
			90 01 00 00 00 00 00 00 c8 00 00 00 03 00 00 00
			20 00 00 00 03 00 00 00 10 00 00 00 00 00 00 00
			90 01 00 00 00 00 00 00 c8 00 00 00 03 00 00 00
			20 00 00 00 03 00 00 00 10 00 00 00 00 00 00 00
			90 01 00 00 00 00 00 00 c8 00 00 00 03 00 00 00
			20 00 00 00 03 00 00 00 10 00 00 00 00 00 00 00
			90 01 00 00 00 00 00 00 c8 00 00 00 03 00 00 00
			20 00 00 00 03 00 00 00 10 00 00 00 00 00 00 00
			90 01 00 00 00 00 00 00 c8 00 00 00 03 00 00 00
			20 00 00 00 03 00 00 00 10 00 00 00 00 00 00 00
			90 01 00 00 00 00 00 00 c8 00 00 00 03 00 00 00
			20 00 00 00 03 00 00 00 10 00 00 00 00 00 00 00
			90 01 00 00 00 00 00 00 c8 00 00 00 03 00 00 00
			20 00 00 00 03 00 00 00 10 00 00 00 00 00 00 00
			90 01 00 00 00 00 00 00 c8 00 00 00 03 00 00 00
			20 00 00 00 03 00 00 00 10 00 00 00 00 00 00 00
			90 01 00 00 00 00 00 00 c8 00 00 00 03 00 00 00
			20 00 00 00 03 00 00 00 10 00 00 00 00 00 00 00
			90 01 00 00 00 00 00 00 c8 00 00 00 03 00 00 00
			20 00 00 00 03 00 00 00 10 00 00 00 00 00 00 00
			90 01 00 00 00 00 00 00 c8 00 00 00 03 00 00 00
			20 00 00 00 03 00 00 00 10 00 00 00 00 00 00 00
			90 01 00 00 00 00 00 00 c8 00 00 00 03 00 00 00
			20 00 00 00 03 00 00 00 10 00 00 00 00 00 00 00
			90 01 00 00 00 00 00 00 c8 00 00 00 03 00 00 00
			20 00 00 00 03 00 00 00 10 00 00 00 00 00 00 00
			90 01 00 00 00 00 00 00 c8 00 00 00 03 00 00 00
			20 00 00 00 03 00 00 00 10 00 00 00 00 00 00 00
			90 01 00 00 00 00 00 00 c8 00 00 00 03 00 00 00
			20 00 00 00 03 00 00 00 10 00 00 00 00 00 00 00
			90 01 00 00 00 00 00 00 c8 00 00 00 03 00 00 00
			20 00 00 00 03 00 00 00 10 00 00 00 00 00 00 00
			90 01 00 00 00 00 00 00 c8 00 00 00 03 00 00 00
			20 00 00 00 03 00 00 00 10 00 00 00 00 00 00 00
			90 01 00 00 00 00 00 00 c8 00 00 00 03 00 00 00
			20 00 00 00 03 00 00 00 10 00 00 00 00 00 00 00
			90 01 00 00 00 00 00 00 c8 00 00 00 03 00 00 00
			20 00 00 00 03 00 00 00 10 00 00 00 00 00 00 00
			90 01 00 00 00 00 00 00 c8 00 00 00 03 00 00 00
			20 00 00 00 03 00 00 00 10 00 00 00 00 00 00 00
			90 01 00 00 00 00 00 00 c8 00 00 00 03 00 00 00
			20 00 00 00 03 00 00 00 10 00 00 00 00 00 00 00
			90 01 00 00 00 00 00 00 c8 00 00 00 03 00 00 00
			20 00 00 00 03 00 00 00 10 00 00 00 00 00 00 00
			90 01 00 00 00 00 00 00 c8 00 00 00 03 00 00 00
		];
		no-shutdown = [01 00 00 00];
		dvfs-disp = [00 00 00 00];
		sram-index = [01 00 00 00];
		dvfs-domain = [
			01 00 00 00 05 00 00 00 00 00 00 00 44 43 53 00
			00 00 00 00 00 00 00 00 00 00 00 00 02 00 00 00
			04 00 00 00 00 00 00 00 53 4f 43 00 00 00 00 00
			00 00 00 00 00 00 00 00 04 00 00 00 03 00 00 00
			00 00 00 00 41 56 45 00 00 00 00 00 00 00 00 00
			00 00 00 00 03 00 00 00 06 00 00 00 00 00 00 00
			44 49 53 50 00 00 00 00 00 00 00 00 00 00 00 00
		];
		dvfs-disp-min-state = [00 00 00 00];
		fast-die-ctrl-ce-map = [
			01 00 00 00 00 00 00 00 00 00 00 00 01 00 00 00
			00 00 00 00 00 00 00 00 00 00 00 00 45 41 43 43
			00 00 00 00 00 00 00 00 00 00 00 00 02 00 00 00
			00 00 00 00 01 00 00 00 02 00 00 00 03 00 00 00
			00 00 00 00 00 00 00 00 50 41 43 43 5f 41 4e 45
			00 00 00 00 00 00 00 00
		];
		soc-ni2-bw-threshold = [
			00 00 00 00 00 00 00 00 00 00 00 00 00 00 00 00
			00 00 00 00 00 00 00 00 00 00 00 00 03 00 00 00
			00 00 00 00 00 00 00 00 00 00 00 00 03 00 00 00
			00 00 00 00 00 00 00 00 00 00 00 00 03 00 00 00
		];
		agx-dcs-lat-dvfs-filter = [00 00 00 00];
		user-power-managed = [01 00 00 00];
		ane-af-bw-threshold = [
			00 00 18 00 00 00 00 00 00 00 00 00 00 00 00 00
			00 00 20 00 00 00 00 00 00 00 17 00 03 00 00 00
			00 00 30 00 00 00 00 00 00 00 1f 00 03 00 00 00
			00 00 00 00 00 00 00 00 00 00 2f 00 03 00 00 00
			00 00 18 00 00 00 00 00 00 00 00 00 00 00 00 00
			00 00 20 00 00 00 00 00 00 00 17 00 03 00 00 00
			00 00 30 00 00 00 00 00 00 00 1f 00 03 00 00 00
			00 00 00 00 00 00 00 00 00 00 2f 00 03 00 00 00
			00 00 18 00 00 00 00 00 00 00 00 00 00 00 00 00
			00 00 20 00 00 00 00 00 00 00 17 00 03 00 00 00
			00 00 30 00 00 00 00 00 00 00 1f 00 03 00 00 00
			00 00 00 00 00 00 00 00 00 00 2f 00 03 00 00 00
			00 00 18 00 00 00 00 00 00 00 00 00 00 00 00 00
			00 00 20 00 00 00 00 00 00 00 17 00 03 00 00 00
			00 00 30 00 00 00 00 00 00 00 1f 00 03 00 00 00
			00 00 00 00 00 00 00 00 00 00 2f 00 03 00 00 00
			00 00 18 00 00 00 00 00 00 00 00 00 00 00 00 00
			00 00 20 00 00 00 00 00 00 00 17 00 03 00 00 00
			00 00 30 00 00 00 00 00 00 00 1f 00 03 00 00 00
			00 00 00 00 00 00 00 00 00 00 2f 00 03 00 00 00
			00 00 05 00 00 00 00 00 00 00 00 00 00 00 00 00
			00 00 08 00 00 00 00 00 00 00 04 00 05 00 00 00
			00 00 30 00 00 00 00 00 00 00 07 00 05 00 00 00
			00 00 00 00 00 00 00 00 00 00 2f 00 05 00 00 00
			00 00 05 00 00 00 00 00 00 00 00 00 00 00 00 00
			00 00 08 00 00 00 00 00 00 00 04 00 05 00 00 00
			00 00 30 00 00 00 00 00 00 00 07 00 05 00 00 00
			00 00 00 00 00 00 00 00 00 00 2f 00 05 00 00 00
			00 00 05 00 00 00 00 00 00 00 00 00 00 00 00 00
			00 00 08 00 00 00 00 00 00 00 04 00 05 00 00 00
			00 00 30 00 00 00 00 00 00 00 07 00 05 00 00 00
			00 00 00 00 00 00 00 00 00 00 2f 00 05 00 00 00
			00 00 05 00 00 00 00 00 00 00 00 00 00 00 00 00
			00 00 08 00 00 00 00 00 00 00 04 00 05 00 00 00
			00 00 30 00 00 00 00 00 00 00 07 00 05 00 00 00
			00 00 00 00 00 00 00 00 00 00 2f 00 05 00 00 00
			00 00 02 00 00 00 00 00 00 00 00 00 00 00 00 00
			00 00 04 00 00 00 00 00 00 00 01 00 05 00 00 00
			00 00 18 00 00 00 00 00 00 00 03 00 05 00 00 00
			00 00 00 00 00 00 00 00 00 00 17 00 05 00 00 00
			00 00 02 00 00 00 00 00 00 00 00 00 00 00 00 00
			00 00 04 00 00 00 00 00 00 00 01 00 05 00 00 00
			00 00 18 00 00 00 00 00 00 00 03 00 05 00 00 00
			00 00 00 00 00 00 00 00 00 00 17 00 05 00 00 00
			00 00 02 00 00 00 00 00 00 00 00 00 00 00 00 00
			00 00 04 00 00 00 00 00 00 00 01 00 05 00 00 00
			00 00 18 00 00 00 00 00 00 00 03 00 05 00 00 00
			00 00 00 00 00 00 00 00 00 00 17 00 05 00 00 00
			00 00 02 00 00 00 00 00 00 00 00 00 00 00 00 00
			00 00 04 00 00 00 00 00 00 00 01 00 05 00 00 00
			00 00 18 00 00 00 00 00 00 00 03 00 05 00 00 00
			00 00 00 00 00 00 00 00 00 00 17 00 05 00 00 00
			00 00 02 00 00 00 00 00 00 00 00 00 00 00 00 00
			00 00 04 00 00 00 00 00 00 00 01 00 05 00 00 00
			00 00 18 00 00 00 00 00 00 00 03 00 05 00 00 00
			00 00 00 00 00 00 00 00 00 00 17 00 05 00 00 00
			00 00 02 00 00 00 00 00 00 00 00 00 00 00 00 00
			00 00 04 00 00 00 00 00 00 00 01 00 05 00 00 00
			00 00 18 00 00 00 00 00 00 00 03 00 05 00 00 00
			00 00 00 00 00 00 00 00 00 00 17 00 05 00 00 00
		];
		lts-voltage = [
			01 00 00 00 03 00 00 00 03 00 00 00 01 00 00 00
			45 41 43 43 00 00 00 00 02 00 00 00 03 00 00 00
			04 00 00 00 02 00 00 00 50 41 43 43 00 00 00 00
			03 00 00 00 01 00 00 00 06 00 00 00 00 00 00 00
			41 4e 45 00 00 00 00 00 04 00 00 00 03 00 00 00
			05 00 00 00 04 00 00 00 41 47 58 00 00 00 00 00
		];
		ane-dcs-bw-threshold = [
			00 00 09 00 00 00 00 00 00 00 00 00 00 00 00 00
			00 00 12 00 00 00 00 00 00 00 08 00 03 00 00 00
			00 00 1d 00 00 00 00 00 00 00 11 00 03 00 00 00
			00 00 c8 00 00 00 00 00 00 00 1c 00 03 00 00 00
			00 00 00 00 00 00 00 00 00 00 c7 00 03 00 00 00
			00 00 09 00 00 00 00 00 00 00 00 00 00 00 00 00
			00 00 12 00 00 00 00 00 00 00 08 00 03 00 00 00
			00 00 1d 00 00 00 00 00 00 00 11 00 03 00 00 00
			00 00 c8 00 00 00 00 00 00 00 1c 00 03 00 00 00
			00 00 00 00 00 00 00 00 00 00 c7 00 03 00 00 00
			00 00 09 00 00 00 00 00 00 00 00 00 00 00 00 00
			00 00 12 00 00 00 00 00 00 00 08 00 03 00 00 00
			00 00 1d 00 00 00 00 00 00 00 11 00 03 00 00 00
			00 00 c8 00 00 00 00 00 00 00 1c 00 03 00 00 00
			00 00 00 00 00 00 00 00 00 00 c7 00 03 00 00 00
			00 00 09 00 00 00 00 00 00 00 00 00 00 00 00 00
			00 00 12 00 00 00 00 00 00 00 08 00 03 00 00 00
			00 00 1d 00 00 00 00 00 00 00 11 00 03 00 00 00
			00 00 27 00 00 00 00 00 00 00 1c 00 03 00 00 00
			00 00 00 00 00 00 00 00 00 00 26 00 03 00 00 00
			00 00 09 00 00 00 00 00 00 00 00 00 00 00 00 00
			00 00 12 00 00 00 00 00 00 00 08 00 03 00 00 00
			00 00 1d 00 00 00 00 00 00 00 11 00 03 00 00 00
			00 00 27 00 00 00 00 00 00 00 1c 00 03 00 00 00
			00 00 00 00 00 00 00 00 00 00 26 00 03 00 00 00
			00 00 02 00 00 00 00 00 00 00 00 00 00 00 00 00
			00 00 08 00 00 00 00 00 00 00 01 00 05 00 00 00
			00 00 0c 00 00 00 00 00 00 00 07 00 05 00 00 00
			00 00 16 00 00 00 00 00 00 00 0b 00 05 00 00 00
			00 00 00 00 00 00 00 00 00 00 15 00 05 00 00 00
			00 00 02 00 00 00 00 00 00 00 00 00 00 00 00 00
			00 00 08 00 00 00 00 00 00 00 01 00 05 00 00 00
			00 00 0c 00 00 00 00 00 00 00 07 00 05 00 00 00
			00 00 16 00 00 00 00 00 00 00 0b 00 05 00 00 00
			00 00 00 00 00 00 00 00 00 00 15 00 05 00 00 00
			00 00 02 00 00 00 00 00 00 00 00 00 00 00 00 00
			00 00 08 00 00 00 00 00 00 00 01 00 05 00 00 00
			00 00 0c 00 00 00 00 00 00 00 07 00 05 00 00 00
			00 00 16 00 00 00 00 00 00 00 0b 00 05 00 00 00
			00 00 00 00 00 00 00 00 00 00 15 00 05 00 00 00
			00 00 02 00 00 00 00 00 00 00 00 00 00 00 00 00
			00 00 08 00 00 00 00 00 00 00 01 00 05 00 00 00
			00 00 0c 00 00 00 00 00 00 00 07 00 05 00 00 00
			00 00 16 00 00 00 00 00 00 00 0b 00 05 00 00 00
			00 00 00 00 00 00 00 00 00 00 15 00 05 00 00 00
			00 00 02 00 00 00 00 00 00 00 00 00 00 00 00 00
			00 00 04 00 00 00 00 00 00 00 01 00 05 00 00 00
			00 00 06 00 00 00 00 00 00 00 03 00 05 00 00 00
			00 00 0b 00 00 00 00 00 00 00 05 00 05 00 00 00
			00 00 00 00 00 00 00 00 00 00 0a 00 05 00 00 00
			00 00 02 00 00 00 00 00 00 00 00 00 00 00 00 00
			00 00 04 00 00 00 00 00 00 00 01 00 05 00 00 00
			00 00 06 00 00 00 00 00 00 00 03 00 05 00 00 00
			00 00 0b 00 00 00 00 00 00 00 05 00 05 00 00 00
			00 00 00 00 00 00 00 00 00 00 0a 00 05 00 00 00
			00 00 02 00 00 00 00 00 00 00 00 00 00 00 00 00
			00 00 04 00 00 00 00 00 00 00 01 00 05 00 00 00
			00 00 06 00 00 00 00 00 00 00 03 00 05 00 00 00
			00 00 0b 00 00 00 00 00 00 00 05 00 05 00 00 00
			00 00 00 00 00 00 00 00 00 00 0a 00 05 00 00 00
			00 00 02 00 00 00 00 00 00 00 00 00 00 00 00 00
			00 00 04 00 00 00 00 00 00 00 01 00 05 00 00 00
			00 00 06 00 00 00 00 00 00 00 03 00 05 00 00 00
			00 00 0b 00 00 00 00 00 00 00 05 00 05 00 00 00
			00 00 00 00 00 00 00 00 00 00 0a 00 05 00 00 00
			00 00 02 00 00 00 00 00 00 00 00 00 00 00 00 00
			00 00 04 00 00 00 00 00 00 00 01 00 05 00 00 00
			00 00 06 00 00 00 00 00 00 00 03 00 05 00 00 00
			00 00 0b 00 00 00 00 00 00 00 05 00 05 00 00 00
			00 00 00 00 00 00 00 00 00 00 0a 00 05 00 00 00
			00 00 02 00 00 00 00 00 00 00 00 00 00 00 00 00
			00 00 04 00 00 00 00 00 00 00 01 00 05 00 00 00
			00 00 06 00 00 00 00 00 00 00 03 00 05 00 00 00
			00 00 0b 00 00 00 00 00 00 00 05 00 05 00 00 00
			00 00 00 00 00 00 00 00 00 00 0a 00 05 00 00 00
		];
		bwr-catch-up-factor = [00 00 01 00];
		controller = [
			01 00 00 00 1f 00 00 00 43 00 00 00 00 00 00 00
			00 00 00 00 44 49 45 2d 54 45 4d 50 00 00 00 00
			00 00 00 00 00 00 00 00 00 00 00 00 00 00 00 00
			00 00 00 00 02 00 00 00 00 00 00 00 00 00 00 00
			00 00 00 00 00 00 00 00 44 43 53 2d 42 57 00 00
			00 00 00 00 00 00 00 00 00 00 00 00 00 00 00 00
			00 00 00 00 00 00 00 00 03 00 00 00 00 00 00 00
			00 00 00 00 00 00 00 00 00 00 00 00 44 43 53 2d
			57 52 2d 42 57 00 00 00 00 00 00 00 00 00 00 00
			00 00 00 00 00 00 00 00 00 00 00 00 04 00 00 00
			00 00 00 00 00 00 00 00 00 00 00 00 00 00 00 00
			41 46 49 2d 54 4f 50 2d 42 57 00 00 00 00 00 00
			00 00 00 00 00 00 00 00 00 00 00 00 00 00 00 00
			05 00 00 00 00 00 00 00 00 00 00 00 00 00 00 00
			00 00 00 00 53 4f 43 2d 4e 49 30 2d 42 57 00 00
			00 00 00 00 00 00 00 00 00 00 00 00 00 00 00 00
			00 00 00 00 06 00 00 00 00 00 00 00 00 00 00 00
			00 00 00 00 00 00 00 00 53 4f 43 2d 4e 49 31 2d
			42 57 00 00 00 00 00 00 00 00 00 00 00 00 00 00
			00 00 00 00 00 00 00 00 07 00 00 00 00 00 00 00
			00 00 00 00 00 00 00 00 00 00 00 00 53 4f 43 2d
			4e 49 32 2d 42 57 00 00 00 00 00 00 00 00 00 00
			00 00 00 00 00 00 00 00 00 00 00 00 08 00 00 00
			00 00 00 00 00 00 00 00 00 00 00 00 00 00 00 00
			41 4e 45 2d 44 43 53 2d 42 57 00 00 00 00 00 00
			00 00 00 00 00 00 00 00 00 00 00 00 00 00 00 00
			0a 00 00 00 00 00 00 00 00 00 00 00 00 00 00 00
			00 00 00 00 41 4e 45 2d 41 46 2d 42 57 00 00 00
			00 00 00 00 00 00 00 00 00 00 00 00 00 00 00 00
			00 00 00 00 11 00 00 00 0e 00 00 00 1e 00 00 00
			00 00 00 00 00 00 00 00 4d 45 4d 2d 43 41 43 48
			45 00 00 00 00 00 00 00 00 00 00 00 00 00 00 00
			00 00 00 00 00 00 00 00 12 00 00 00 00 00 00 00
			00 00 00 00 00 00 00 00 00 00 00 00 41 47 58 2d
			41 46 2d 52 44 2d 42 57 00 00 00 00 00 00 00 00
			00 00 00 00 00 00 00 00 00 00 00 00 14 00 00 00
			00 00 00 00 00 00 00 00 00 00 00 00 00 00 00 00
			41 47 58 2d 41 46 2d 57 52 2d 42 57 00 00 00 00
			00 00 00 00 00 00 00 00 00 00 00 00 00 00 00 00
			16 00 00 00 00 00 00 00 00 00 00 00 00 00 00 00
			00 00 00 00 41 47 58 2d 44 43 53 2d 42 57 00 00
			00 00 00 00 00 00 00 00 00 00 00 00 00 00 00 00
			00 00 00 00 17 00 00 00 52 00 00 00 00 00 00 00
			00 00 00 00 00 00 00 00 4c 49 46 45 54 49 4d 45
			2d 53 45 52 56 4f 00 00 00 00 00 00 00 00 00 00
			00 00 00 00 00 00 00 00 40 00 00 00 00 00 00 00
			00 00 00 00 00 00 00 00 00 00 00 00 41 47 58 2d
			41 46 2d 4c 41 54 00 00 00 00 00 00 00 00 00 00
			00 00 00 00 00 00 00 00 00 00 00 00 42 00 00 00
			00 00 00 00 00 00 00 00 00 00 00 00 00 00 00 00
			41 47 58 2d 44 43 53 2d 4c 41 54 00 00 00 00 00
			00 00 00 00 00 00 00 00 00 00 00 00 00 00 00 00
		];
		soc-device-ps-group = [80 ff 0f 08 00 00 00 00];
		agx-dcs-bw-threshold = [
			00 00 00 00 00 00 00 00 00 00 00 00 00 00 00 00
			00 00 00 00 00 00 00 00 00 00 00 00 05 00 00 00
			00 00 00 00 00 00 00 00 00 00 00 00 05 00 00 00
			00 00 00 00 00 00 00 00 00 00 00 00 05 00 00 00
			00 00 00 00 00 00 00 00 00 00 00 00 05 00 00 00
			00 00 0a 00 00 00 00 00 00 00 00 00 00 00 00 00
			00 00 14 00 00 00 00 00 00 00 09 00 00 00 00 00
			00 00 1d 00 00 00 00 00 00 00 13 00 00 00 00 00
			00 00 c8 00 00 00 00 00 00 00 1c 00 00 00 00 00
			00 00 00 00 00 00 00 00 00 00 c7 00 00 00 00 00
			00 00 04 00 00 00 00 00 00 00 00 00 00 00 00 00
			00 00 14 00 00 00 00 00 00 00 03 00 05 00 00 00
			00 00 1d 00 00 00 00 00 00 00 13 00 05 00 00 00
			00 00 c8 00 00 00 00 00 00 00 1c 00 05 00 00 00
			00 00 00 00 00 00 00 00 00 00 c7 00 05 00 00 00
			00 00 04 00 00 00 00 00 00 00 00 00 00 00 00 00
			00 00 14 00 00 00 00 00 00 00 03 00 05 00 00 00
			00 00 1d 00 00 00 00 00 00 00 13 00 05 00 00 00
			00 00 c8 00 00 00 00 00 00 00 1c 00 05 00 00 00
			00 00 00 00 00 00 00 00 00 00 c7 00 05 00 00 00
			00 00 02 00 00 00 00 00 00 00 00 00 00 00 00 00
			00 00 0a 00 00 00 00 00 00 00 01 00 05 00 00 00
			00 00 1d 00 00 00 00 00 00 00 09 00 05 00 00 00
			00 00 2c 00 00 00 00 00 00 00 1c 00 05 00 00 00
			00 00 00 00 00 00 00 00 00 00 2b 00 05 00 00 00
			00 00 02 00 00 00 00 00 00 00 00 00 00 00 00 00
			00 00 02 00 00 00 00 00 00 00 01 00 05 00 00 00
			00 00 0a 00 00 00 00 00 00 00 01 00 05 00 00 00
			00 00 23 00 00 00 00 00 00 00 09 00 05 00 00 00
			00 00 00 00 00 00 00 00 00 00 22 00 05 00 00 00
			00 00 02 00 00 00 00 00 00 00 00 00 00 00 00 00
			00 00 02 00 00 00 00 00 00 00 01 00 05 00 00 00
			00 00 04 00 00 00 00 00 00 00 01 00 05 00 00 00
			00 00 19 00 00 00 00 00 00 00 03 00 05 00 00 00
			00 00 00 00 00 00 00 00 00 00 18 00 05 00 00 00
			00 00 01 00 00 00 00 00 00 00 00 00 00 00 00 00
			00 00 01 00 00 00 00 00 00 00 00 00 05 00 00 00
			00 00 01 00 00 00 00 00 00 00 00 00 05 00 00 00
			00 00 09 00 00 00 00 00 00 00 00 00 05 00 00 00
			00 00 00 00 00 00 00 00 00 00 08 00 05 00 00 00
			00 00 01 00 00 00 00 00 00 00 00 00 00 00 00 00
			00 00 01 00 00 00 00 00 00 00 00 00 05 00 00 00
			00 00 01 00 00 00 00 00 00 00 00 00 05 00 00 00
			00 00 01 00 00 00 00 00 00 00 00 00 05 00 00 00
			00 00 00 00 00 00 00 00 00 00 00 00 05 00 00 00
			00 00 01 00 00 00 00 00 00 00 00 00 00 00 00 00
			00 00 01 00 00 00 00 00 00 00 00 00 05 00 00 00
			00 00 01 00 00 00 00 00 00 00 00 00 05 00 00 00
			00 00 01 00 00 00 00 00 00 00 00 00 05 00 00 00
			00 00 00 00 00 00 00 00 00 00 00 00 05 00 00 00
			00 00 01 00 00 00 00 00 00 00 00 00 00 00 00 00
			00 00 01 00 00 00 00 00 00 00 00 00 05 00 00 00
			00 00 01 00 00 00 00 00 00 00 00 00 05 00 00 00
			00 00 01 00 00 00 00 00 00 00 00 00 05 00 00 00
			00 00 00 00 00 00 00 00 00 00 00 00 05 00 00 00
		];
		soc-ni1-bw-threshold = [
			00 00 00 00 00 00 00 00 00 00 00 00 00 00 00 00
			00 00 00 00 00 00 00 00 00 00 00 00 03 00 00 00
			00 00 00 00 00 00 00 00 00 00 00 00 03 00 00 00
			00 00 00 00 00 00 00 00 00 00 00 00 03 00 00 00
		];
		mc_quota_rsp_ptd_count = [08 00 00 00];
		lts-ctrl-ts = [00 00 05 00];
		dcs-wr-bw-threshold = [
			00 00 23 00 00 00 00 00 00 00 00 00 00 00 00 00
			00 00 00 00 00 00 00 00 00 00 22 00 03 00 00 00
			00 00 00 00 00 00 00 00 00 00 00 00 00 00 00 00
			00 00 00 00 00 00 00 00 00 00 00 00 00 00 00 00
		];
		agx-af-wr-bw-dvfs-filter = [fe 0f 00 00];
		temp-sensor = [
			01 00 00 00 06 00 00 00 06 00 00 00 00 00 00 00
			00 00 00 00 00 00 00 00 00 00 00 00 00 00 00 00
			6b 00 00 00 7d 00 00 00 54 61 30 30 30 6d 00 00
			00 00 00 00 00 00 00 00 02 00 00 00 06 00 00 00
			03 00 00 00 00 00 00 00 00 00 00 00 00 00 00 00
			00 00 00 00 00 00 00 00 6b 00 00 00 7d 00 00 00
			54 65 30 30 30 6d 00 00 00 00 00 00 00 00 00 00
			03 00 00 00 06 00 00 00 03 00 00 00 01 00 00 00
			00 00 00 00 00 00 00 00 00 00 00 00 00 00 00 00
			6b 00 00 00 7d 00 00 00 54 65 30 30 31 6d 00 00
			00 00 00 00 00 00 00 00 04 00 00 00 06 00 00 00
			04 00 00 00 00 00 00 00 00 00 00 00 00 00 00 00
			00 00 00 00 00 00 00 00 6b 00 00 00 7d 00 00 00
			54 70 30 30 30 6d 00 00 00 00 00 00 00 00 00 00
			05 00 00 00 06 00 00 00 04 00 00 00 01 00 00 00
			00 00 00 00 00 00 00 00 00 00 00 00 00 00 00 00
			6b 00 00 00 7d 00 00 00 54 70 30 30 31 6d 00 00
			00 00 00 00 00 00 00 00 06 00 00 00 01 00 00 00
			05 00 00 00 00 00 00 00 00 00 00 00 00 00 00 00
			00 00 00 00 00 00 00 00 6d 00 00 00 6d 00 00 00
			4d 54 52 5f 54 4f 50 5f 41 47 58 00 00 00 00 00
		];
		dcs-bw-threshold = [
			33 f3 09 00 01 00 00 00 00 00 00 00 00 00 00 00
			33 f3 13 00 02 00 00 00 33 f3 08 00 00 00 00 00
			70 fd 1c 00 03 00 00 00 33 f3 12 00 00 00 00 00
			1e 85 2b 00 04 00 00 00 70 fd 1b 00 00 00 00 00
			00 00 00 00 00 00 00 00 1e 85 2a 00 00 00 00 00
		];
		mc_cmd_ack_ptd_count = [01 00 00 00];
		soc-ni0-bw-threshold = [
			00 00 00 00 00 00 00 00 00 00 00 00 00 00 00 00
			00 00 00 00 00 00 00 00 00 00 00 00 03 00 00 00
			00 00 00 00 00 00 00 00 00 00 00 00 03 00 00 00
			00 00 00 00 00 00 00 00 00 00 00 00 03 00 00 00
		];
		fast-die-ctrl-loop = [
			01 00 00 00 00 00 00 00 00 00 00 00 ae 05 00 00
			cc cc 07 00 00 00 6b 00 00 00 01 00 00 00 00 00
			00 00 01 00 00 00 00 00 00 00 00 00 00 00 05 00
			16 00 00 00 02 00 00 00 03 00 00 00 00 00 00 00
			00 00 00 00 00 00 00 00 00 00 00 00 00 00 00 00
			00 00 00 00 00 00 00 00 00 00 00 00 00 00 00 00
			00 00 00 00 00 00 00 00 00 00 00 00 00 00 00 00
			00 00 00 00 45 41 43 43 00 00 00 00 00 00 00 00
			00 00 00 00 02 00 00 00 00 00 00 00 01 00 00 00
			ae 05 00 00 cc cc 07 00 00 00 6b 00 00 00 01 00
			00 00 00 00 00 00 01 00 00 00 00 00 00 00 00 00
			00 00 05 00 16 00 00 00 04 00 00 00 05 00 00 00
			00 00 00 00 00 00 00 00 00 00 00 00 00 00 00 00
			00 00 00 00 00 00 00 00 00 00 00 00 00 00 00 00
			00 00 00 00 00 00 00 00 00 00 00 00 00 00 00 00
			00 00 00 00 00 00 00 00 50 41 43 43 00 00 00 00
			00 00 00 00 00 00 00 00 03 00 00 00 00 00 00 00
			02 00 00 00 ae 05 00 00 cc cc 07 00 00 00 6b 00
			00 00 01 00 00 00 00 00 00 00 01 00 00 00 00 00
			00 00 00 00 00 00 05 00 16 00 00 00 01 00 00 00
			00 00 00 00 00 00 00 00 00 00 00 00 00 00 00 00
			00 00 00 00 00 00 00 00 00 00 00 00 00 00 00 00
			00 00 00 00 00 00 00 00 00 00 00 00 00 00 00 00
			00 00 00 00 00 00 00 00 00 00 00 00 41 4e 45 00
			00 00 00 00 00 00 00 00 00 00 00 00
		];
		agx-af-lat-dvfs-filter = [00 00 00 00];
		agx-dcs-bw-dvfs-filter = [fe 0f 00 00];
		agx-af-rd-bw-dvfs-filter = [fe 0f 00 00];
		firmware-name = [74 38 31 34 30 70 6d 70 00];
		energy-counter = [
			01 00 00 00 00 00 00 00 0f 00 00 00 00 00 00 00
			56 44 45 43 00 00 00 00 00 00 00 00 00 00 00 00
			02 00 00 00 00 00 00 00 10 00 00 00 00 00 00 00
			53 4f 43 5f 41 4f 4e 00 00 00 00 00 00 00 00 00
			03 00 00 00 00 00 00 00 11 00 00 00 00 00 00 00
			53 4f 43 5f 52 45 53 54 00 00 00 00 00 00 00 00
		];
		mcache-stream = [
			1e 00 00 00 03 00 00 00 01 00 00 00 0b 00 00 00
			0b 00 00 00 0e 00 00 00 0e 00 00 00 02 00 00 00
			00 00 00 00 00 00 00 00 04 00 00 00 01 00 00 00
			1f 00 00 00 03 00 00 00 01 00 00 00 0b 00 00 00
			0b 00 00 00 23 00 00 00 23 00 00 00 02 00 00 00
			00 00 00 00 00 00 00 00 04 00 00 00 01 00 00 00
			2b 00 00 00 03 00 00 00 01 00 00 00 0b 00 00 00
			0b 00 00 00 39 00 00 00 39 00 00 00 02 00 00 00
			00 00 00 00 00 00 00 00 04 00 00 00 01 00 00 00
			05 00 00 00 01 00 00 00 01 00 00 00 02 00 00 00
			02 00 00 00 14 00 00 00 14 00 00 00 02 00 00 00
			00 00 00 00 00 00 00 00 04 00 00 00 01 00 00 00
			06 00 00 00 02 00 00 00 01 00 00 00 03 00 00 00
			03 00 00 00 12 00 00 00 12 00 00 00 02 00 00 00
			00 00 00 00 00 00 00 00 04 00 00 00 00 00 00 00
			0b 00 00 00 05 00 00 00 01 00 00 00 05 00 00 00
			05 00 00 00 21 00 00 00 21 00 00 00 02 00 00 00
			00 00 00 00 00 00 00 00 04 00 00 00 01 00 00 00
			0e 00 00 00 04 00 00 00 01 00 00 00 10 00 00 00
			10 00 00 00 15 00 00 00 15 00 00 00 02 00 00 00
			00 00 00 00 00 00 00 00 04 00 00 00 00 00 00 00
			11 00 00 00 04 00 00 00 01 00 00 00 11 00 00 00
			11 00 00 00 16 00 00 00 16 00 00 00 02 00 00 00
			00 00 00 00 00 00 00 00 04 00 00 00 01 00 00 00
			13 00 00 00 04 00 00 00 01 00 00 00 12 00 00 00
			12 00 00 00 17 00 00 00 17 00 00 00 02 00 00 00
			00 00 00 00 00 00 00 00 04 00 00 00 01 00 00 00
			24 00 00 00 04 00 00 00 01 00 00 00 12 00 00 00
			12 00 00 00 18 00 00 00 18 00 00 00 02 00 00 00
			00 00 00 00 00 00 00 00 04 00 00 00 01 00 00 00
			1b 00 00 00 04 00 00 00 01 00 00 00 11 00 00 00
			11 00 00 00 1e 00 00 00 1e 00 00 00 02 00 00 00
			00 00 00 00 00 00 00 00 04 00 00 00 01 00 00 00
			1c 00 00 00 04 00 00 00 01 00 00 00 12 00 00 00
			12 00 00 00 1f 00 00 00 1f 00 00 00 02 00 00 00
			00 00 00 00 00 00 00 00 04 00 00 00 01 00 00 00
			04 00 00 00 00 00 00 00 01 00 00 00 06 00 00 00
			06 00 00 00 0d 00 00 00 0d 00 00 00 02 00 00 00
			00 00 00 00 00 00 00 00 05 00 00 00 01 00 00 00
			02 00 00 00 00 00 00 00 01 00 00 00 04 00 00 00
			04 00 00 00 13 00 00 00 13 00 00 00 02 00 00 00
			00 00 00 00 00 00 00 00 04 00 00 00 01 00 00 00
			10 00 00 00 04 00 00 00 01 00 00 00 18 00 00 00
			18 00 00 00 60 00 00 00 bf 00 00 00 02 00 00 00
			00 00 00 00 00 00 00 00 04 00 00 00 01 00 00 00
			01 00 00 00 00 00 00 00 01 00 00 00 0a 00 00 00
			0a 00 00 00 0a 00 00 00 0c 00 00 00 02 00 00 00
			00 00 00 00 00 00 00 00 04 00 00 00 01 00 00 00
			12 00 00 00 05 00 00 00 02 00 00 00 09 00 00 00
			09 00 00 00 0f 00 00 00 0f 00 00 00 03 00 00 00
			00 00 00 00 00 00 00 00 04 00 00 00 01 00 00 00
			0a 00 00 00 05 00 00 00 02 00 00 00 13 00 00 00
			13 00 00 00 22 00 00 00 22 00 00 00 03 00 00 00
			00 00 00 00 00 00 00 00 04 00 00 00 00 00 00 00
			0f 00 00 00 04 00 00 00 02 00 00 00 19 00 00 00
			19 00 00 00 5f 00 00 00 5f 00 00 00 03 00 00 00
			00 00 00 00 00 00 00 00 04 00 00 00 01 00 00 00
			15 00 00 00 07 00 00 00 02 00 00 00 0f 00 00 00
			0f 00 00 00 11 00 00 00 11 00 00 00 03 00 00 00
			00 00 00 00 00 00 00 00 04 00 00 00 01 00 00 00
			20 00 00 00 03 00 00 00 02 00 00 00 16 00 00 00
			16 00 00 00 24 00 00 00 33 00 00 00 03 00 00 00
			00 00 00 00 00 00 00 00 05 00 00 00 01 00 00 00
			0d 00 00 00 0b 00 00 00 03 00 00 00 08 00 00 00
			08 00 00 00 07 00 00 00 07 00 00 00 01 00 00 00
			00 00 00 00 00 00 00 00 04 00 00 00 00 00 00 00
			0c 00 00 00 0b 00 00 00 03 00 00 00 08 00 00 00
			08 00 00 00 08 00 00 00 08 00 00 00 01 00 00 00
			00 00 00 00 00 00 00 00 04 00 00 00 00 00 00 00
			19 00 00 00 08 00 00 00 03 00 00 00 01 00 00 00
			01 00 00 00 03 00 00 00 03 00 00 00 01 00 00 00
			00 00 00 00 00 00 00 00 04 00 00 00 01 00 00 00
			1a 00 00 00 08 00 00 00 03 00 00 00 01 00 00 00
			01 00 00 00 04 00 00 00 04 00 00 00 01 00 00 00
			00 00 00 00 00 00 00 00 04 00 00 00 01 00 00 00
			29 00 00 00 08 00 00 00 03 00 00 00 01 00 00 00
			01 00 00 00 05 00 00 00 05 00 00 00 01 00 00 00
			00 00 00 00 00 00 00 00 04 00 00 00 01 00 00 00
			2a 00 00 00 08 00 00 00 03 00 00 00 01 00 00 00
			01 00 00 00 06 00 00 00 06 00 00 00 01 00 00 00
			00 00 00 00 00 00 00 00 04 00 00 00 01 00 00 00
			2c 00 00 00 03 00 00 00 03 00 00 00 1a 00 00 00
			1a 00 00 00 40 00 00 00 40 00 00 00 01 00 00 00
			00 00 00 00 00 00 00 00 04 00 00 00 00 00 00 00
			2d 00 00 00 0c 00 00 00 03 00 00 00 1b 00 00 00
			1b 00 00 00 41 00 00 00 41 00 00 00 01 00 00 00
			00 00 00 00 00 00 00 00 04 00 00 00 00 00 00 00
			2f 00 00 00 02 00 00 00 03 00 00 00 1c 00 00 00
			1c 00 00 00 43 00 00 00 43 00 00 00 01 00 00 00
			00 00 00 00 00 00 00 00 04 00 00 00 00 00 00 00
			26 00 00 00 05 00 00 00 03 00 00 00 1d 00 00 00
			1d 00 00 00 44 00 00 00 44 00 00 00 01 00 00 00
			00 00 00 00 00 00 00 00 04 00 00 00 00 00 00 00
			14 00 00 00 04 00 00 00 03 00 00 00 08 00 00 00
			08 00 00 00 09 00 00 00 09 00 00 00 01 00 00 00
			00 00 00 00 00 00 00 00 04 00 00 00 00 00 00 00
			27 00 00 00 04 00 00 00 03 00 00 00 1f 00 00 00
			1f 00 00 00 45 00 00 00 45 00 00 00 01 00 00 00
			00 00 00 00 00 00 00 00 04 00 00 00 00 00 00 00
			23 00 00 00 00 00 00 00 03 00 00 00 0c 00 00 00
			0c 00 00 00 19 00 00 00 19 00 00 00 01 00 00 00
			00 00 00 00 00 00 00 00 04 00 00 00 01 00 00 00
			28 00 00 00 00 00 00 00 03 00 00 00 1f 00 00 00
			1f 00 00 00 46 00 00 00 46 00 00 00 01 00 00 00
			00 00 00 00 00 00 00 00 04 00 00 00 00 00 00 00
			30 00 00 00 0e 00 00 00 03 00 00 00 1e 00 00 00
			1e 00 00 00 47 00 00 00 47 00 00 00 01 00 00 00
			00 00 00 00 00 00 00 00 04 00 00 00 00 00 00 00
			31 00 00 00 0f 00 00 00 03 00 00 00 1e 00 00 00
			1e 00 00 00 48 00 00 00 48 00 00 00 01 00 00 00
			00 00 00 00 00 00 00 00 04 00 00 00 00 00 00 00
			33 00 00 00 11 00 00 00 03 00 00 00 1e 00 00 00
			1e 00 00 00 4b 00 00 00 4b 00 00 00 01 00 00 00
			00 00 00 00 00 00 00 00 04 00 00 00 00 00 00 00
			34 00 00 00 12 00 00 00 03 00 00 00 1e 00 00 00
			1e 00 00 00 4c 00 00 00 4c 00 00 00 01 00 00 00
			00 00 00 00 00 00 00 00 04 00 00 00 00 00 00 00
			16 00 00 00 0b 00 00 00 03 00 00 00 ff ff 00 00
			ff ff 00 00 00 00 00 00 00 00 00 00 01 00 00 00
			00 00 00 00 00 00 00 00 04 00 00 00 00 00 00 00
		];
		ptd-driver-version = [01 00 00 00];
		afi-top-bw-threshold = [
			00 00 00 00 00 00 00 00 00 00 00 00 00 00 00 00
			00 00 00 00 00 00 00 00 00 00 00 00 03 00 00 00
			00 00 00 00 00 00 00 00 00 00 00 00 03 00 00 00
			00 00 00 00 00 00 00 00 00 00 00 00 03 00 00 00
		];
		region-size = [00 00 0a 00 00 00 00 00];
		mc-cue-quota-cfg = [
			01 00 00 00 20 00 00 00 c0 00 00 00 08 00 00 00
			0a 00 00 00 02 00 00 00 c0 00 00 00 c0 00 00 00
			00 00 00 00 0a 00 00 00 08 00 00 00 20 00 00 00
			20 00 00 00 00 00 00 00 0a 00 00 00 09 00 00 00
			08 00 00 00 20 00 00 00 08 00 00 00 0a 00 00 00
			0f 00 00 00 00 00 00 00 c0 00 00 00 00 00 00 00
			0a 00 00 00 10 00 00 00 08 00 00 00 20 00 00 00
			08 00 00 00 0a 00 00 00 11 00 00 00 0c 00 00 00
			c0 00 00 00 08 00 00 00 0a 00 00 00 12 00 00 00
			0c 00 00 00 c0 00 00 00 08 00 00 00 0a 00 00 00
		];
		coredump-enable = [40 00 00 00];
		pm-ptd-ranges = [
			01 00 00 00 02 00 00 00 03 00 00 00 04 00 00 00
			05 00 00 00 06 00 00 00 07 00 00 00 08 00 00 00
			00 00 00 00 09 00 00 00 0a 00 00 00 0b 00 00 00
			0c 00 00 00 0d 00 00 00 00 00 00 00
		];
		fast-die-ctrl-ts-avg-temp = [00 00 64 00];
		lts-ctrl-loop = [
			01 00 00 00 00 00 00 00 00 00 00 00 00 00 00 00
			00 00 00 00 01 00 00 00 01 00 00 00 00 00 00 00
			02 00 00 00 03 00 00 00 00 00 00 00 00 00 00 00
			00 00 00 00 00 00 00 00 00 00 00 00 00 00 00 00
			00 00 00 00 00 00 00 00 00 00 00 00 00 00 00 00
			00 00 00 00 00 00 00 00 00 00 00 00 00 00 00 00
			45 41 43 43 00 00 00 00 00 00 00 00 00 00 00 00
			02 00 00 00 00 00 00 00 01 00 00 00 01 00 00 00
			00 00 00 00 02 00 00 00 02 00 00 00 00 00 00 00
			04 00 00 00 05 00 00 00 00 00 00 00 00 00 00 00
			00 00 00 00 00 00 00 00 00 00 00 00 00 00 00 00
			00 00 00 00 00 00 00 00 00 00 00 00 00 00 00 00
			00 00 00 00 00 00 00 00 00 00 00 00 00 00 00 00
			50 41 43 43 00 00 00 00 00 00 00 00 00 00 00 00
			03 00 00 00 00 00 00 00 02 00 00 00 02 00 00 00
			00 00 00 00 00 00 00 00 04 00 00 00 00 00 00 00
			06 00 00 00 00 00 00 00 00 00 00 00 00 00 00 00
			00 00 00 00 00 00 00 00 00 00 00 00 00 00 00 00
			00 00 00 00 00 00 00 00 00 00 00 00 00 00 00 00
			00 00 00 00 00 00 00 00 00 00 00 00 00 00 00 00
			47 50 55 00 00 00 00 00 00 00 00 00 00 00 00 00
		];
		soc-device = [
			01 00 00 00 45 4e 4f 4e 01 00 00 00 00 00 00 00
			00 00 00 00 00 00 00 00 01 00 00 00 00 00 00 00
			00 00 00 00 00 00 00 00 00 00 00 00 00 00 00 00
			00 00 00 00 00 00 00 00 00 00 00 00 00 00 00 00
			00 00 00 00 00 00 00 00 00 00 00 00 00 00 00 00
			00 00 00 00 00 00 00 00 00 00 00 00 00 00 00 00
			00 00 00 00 00 00 00 00 00 00 00 00 00 00 00 00
			00 00 00 00 44 43 53 00 00 00 00 00 02 00 00 00
			45 4e 4f 4e 01 00 00 00 13 00 00 00 00 00 00 00
			00 00 00 00 02 00 00 00 00 00 00 00 00 00 00 00
			00 00 00 00 00 00 00 00 00 00 00 00 00 00 00 00
			00 00 00 00 00 00 00 00 00 00 00 00 00 00 00 00
			00 00 00 00 00 00 00 00 00 00 00 00 00 00 00 00
			00 00 00 00 00 00 00 00 00 00 00 00 00 00 00 00
			00 00 00 00 00 00 00 00 00 00 00 00 00 00 00 00
			41 4d 43 43 00 00 00 00 13 00 00 00 45 4e 4f 4e
			01 00 00 00 05 00 00 00 00 00 00 00 00 00 00 00
			02 00 00 00 00 00 00 00 00 00 00 00 00 00 00 00
			00 00 00 00 00 00 00 00 00 00 00 00 00 00 00 00
			00 00 00 00 00 00 00 00 00 00 00 00 00 00 00 00
			00 00 00 00 00 00 00 00 00 00 00 00 00 00 00 00
			00 00 00 00 00 00 00 00 00 00 00 00 00 00 00 00
			00 00 00 00 00 00 00 00 00 00 00 00 53 4f 43 2d
			4e 49 30 00 14 00 00 00 45 4e 4f 4e 01 00 00 00
			05 00 00 00 00 00 00 00 00 00 00 00 02 00 00 00
			00 00 00 00 00 00 00 00 00 00 00 00 00 00 00 00
			00 00 00 00 00 00 00 00 00 00 00 00 00 00 00 00
			00 00 00 00 00 00 00 00 00 00 00 00 00 00 00 00
			00 00 00 00 00 00 00 00 00 00 00 00 00 00 00 00
			00 00 00 00 00 00 00 00 00 00 00 00 00 00 00 00
			00 00 00 00 00 00 00 00 53 4f 43 2d 4e 49 31 00
			15 00 00 00 45 4e 4f 4e 01 00 00 00 05 00 00 00
			00 00 00 00 00 00 00 00 02 00 00 00 00 00 00 00
			00 00 00 00 00 00 00 00 00 00 00 00 00 00 00 00
			00 00 00 00 00 00 00 00 00 00 00 00 00 00 00 00
			00 00 00 00 00 00 00 00 00 00 00 00 00 00 00 00
			00 00 00 00 00 00 00 00 00 00 00 00 00 00 00 00
			00 00 00 00 00 00 00 00 00 00 00 00 00 00 00 00
			00 00 00 00 53 4f 43 2d 4e 49 32 00 11 00 00 00
			45 4e 4f 4e 01 00 00 00 00 00 00 00 10 00 00 00
			00 00 00 00 02 00 00 00 00 00 00 00 00 00 00 00
			00 00 00 00 00 00 00 00 00 00 00 00 00 00 00 00
			00 00 00 00 00 00 00 00 00 00 00 00 00 00 00 00
			00 00 00 00 00 00 00 00 00 00 00 00 00 00 00 00
			00 00 00 00 00 00 00 00 00 00 00 00 00 00 00 00
			00 00 00 00 00 00 00 00 00 00 00 00 00 00 00 00
			53 4f 43 2d 41 4f 4e 00 12 00 00 00 45 4e 4f 4e
			01 00 00 00 00 00 00 00 11 00 00 00 00 00 00 00
			02 00 00 00 00 00 00 00 00 00 00 00 00 00 00 00
			00 00 00 00 00 00 00 00 00 00 00 00 00 00 00 00
			00 00 00 00 00 00 00 00 00 00 00 00 00 00 00 00
			00 00 00 00 00 00 00 00 00 00 00 00 00 00 00 00
			00 00 00 00 00 00 00 00 00 00 00 00 00 00 00 00
			00 00 00 00 00 00 00 00 00 00 00 00 53 4f 43 2d
			52 45 53 54 03 00 00 00 45 4e 4f 4e 03 00 00 00
			01 00 00 00 00 00 00 00 00 00 00 00 00 00 00 00
			02 00 00 00 00 00 00 00 00 00 00 00 00 00 00 00
			02 00 00 00 00 00 00 00 00 00 00 00 00 00 00 00
			00 00 00 00 00 00 00 00 00 00 00 00 00 00 00 00
			00 00 00 00 00 00 00 00 00 00 00 00 00 00 00 00
			00 00 00 00 00 00 00 00 00 00 00 00 00 00 00 00
			00 00 00 00 00 00 00 00 45 41 43 43 30 00 00 00
			04 00 00 00 45 4e 4f 4e 03 00 00 00 02 00 00 00
			00 00 00 00 00 00 00 00 00 00 00 00 02 00 00 00
			00 00 00 00 00 00 00 00 00 00 00 00 02 00 00 00
			00 00 00 00 00 00 00 00 00 00 00 00 00 00 00 00
			00 00 00 00 00 00 00 00 00 00 00 00 00 00 00 00
			00 00 00 00 00 00 00 00 00 00 00 00 00 00 00 00
			00 00 00 00 00 00 00 00 00 00 00 00 00 00 00 00
			00 00 00 00 50 41 43 43 30 00 00 00 05 00 00 00
			5f 58 46 47 03 00 00 00 01 00 00 00 00 00 00 00
			00 00 00 00 00 00 00 00 02 00 00 00 00 00 00 00
			00 00 00 00 00 00 00 00 02 00 00 00 00 00 00 00
			00 00 00 00 00 00 00 00 00 00 00 00 00 00 00 00
			00 00 00 00 00 00 00 00 00 00 00 00 00 00 00 00
			00 00 00 00 00 00 00 00 00 00 00 00 00 00 00 00
			00 00 00 00 00 00 00 00 00 00 00 00 00 00 00 00
			41 47 58 00 00 00 00 00 06 00 00 00 45 4e 4f 4e
			03 00 00 00 01 00 00 00 00 00 00 00 00 00 00 00
			00 00 00 00 02 00 00 00 00 00 00 00 00 00 00 00
			00 00 00 00 02 00 00 00 00 00 00 00 00 00 00 00
			00 00 00 00 00 00 00 00 00 00 00 00 00 00 00 00
			00 00 00 00 00 00 00 00 00 00 00 00 00 00 00 00
			00 00 00 00 00 00 00 00 00 00 00 00 00 00 00 00
			00 00 00 00 00 00 00 00 00 00 00 00 41 4e 45 30
			00 00 00 00 07 00 00 00 45 4e 4f 4e 01 00 00 00
			00 00 00 00 00 00 00 00 00 00 00 00 02 00 00 00
			00 00 00 00 00 00 00 00 00 00 00 00 00 00 00 00
			01 00 00 00 03 00 00 00 00 00 00 00 00 00 00 00
			00 00 00 00 00 00 00 00 00 00 00 00 00 00 00 00
			00 00 00 00 00 00 00 00 00 00 00 00 00 00 00 00
			00 00 00 00 00 00 00 00 00 00 00 00 00 00 00 00
			00 00 00 00 00 00 00 00 49 53 50 00 00 00 00 00
			08 00 00 00 45 4e 4f 4e 01 00 00 00 00 00 00 00
			00 00 00 00 00 00 00 00 03 00 00 00 02 00 00 00
			00 00 00 00 00 00 00 00 00 00 00 00 02 00 00 00
			03 00 00 00 00 00 00 00 00 00 00 00 00 00 00 00
			00 00 00 00 00 00 00 00 00 00 00 00 00 00 00 00
			00 00 00 00 00 00 00 00 00 00 00 00 00 00 00 00
			00 00 00 00 00 00 00 00 00 00 00 00 00 00 00 00
			00 00 00 00 44 49 53 50 00 00 00 00 09 00 00 00
			45 4e 4f 4e 01 00 00 00 00 00 00 00 00 00 00 00
			00 00 00 00 03 00 00 00 02 00 00 00 00 00 00 00
			00 00 00 00 00 00 00 00 02 00 00 00 03 00 00 00
			00 00 00 00 00 00 00 00 00 00 00 00 00 00 00 00
			00 00 00 00 00 00 00 00 00 00 00 00 00 00 00 00
			00 00 00 00 00 00 00 00 00 00 00 00 00 00 00 00
			00 00 00 00 00 00 00 00 00 00 00 00 00 00 00 00
			44 49 53 50 45 58 54 00 0f 00 00 00 45 4e 4f 4e
			01 00 00 00 00 00 00 00 00 00 00 00 00 00 00 00
			02 00 00 00 00 00 00 00 00 00 00 00 00 00 00 00
			00 00 00 00 02 00 00 00 00 00 00 00 00 00 00 00
			00 00 00 00 00 00 00 00 00 00 00 00 00 00 00 00
			00 00 00 00 00 00 00 00 00 00 00 00 00 00 00 00
			00 00 00 00 00 00 00 00 00 00 00 00 00 00 00 00
			00 00 00 00 00 00 00 00 00 00 00 00 50 52 4f 52
			45 53 00 00 0a 00 00 00 45 4e 4f 4e 01 00 00 00
			00 00 00 00 00 00 00 00 00 00 00 00 04 00 00 00
			02 00 00 00 00 00 00 00 00 00 00 00 00 00 00 00
			02 00 00 00 00 00 00 00 00 00 00 00 00 00 00 00
			00 00 00 00 00 00 00 00 00 00 00 00 00 00 00 00
			00 00 00 00 00 00 00 00 00 00 00 00 00 00 00 00
			00 00 00 00 00 00 00 00 00 00 00 00 00 00 00 00
			00 00 00 00 00 00 00 00 41 56 45 30 00 00 00 00
			0b 00 00 00 45 4e 4f 4e 01 00 00 00 00 00 00 00
			00 00 00 00 00 00 00 00 04 00 00 00 02 00 00 00
			00 00 00 00 00 00 00 00 00 00 00 00 02 00 00 00
			00 00 00 00 00 00 00 00 00 00 00 00 00 00 00 00
			00 00 00 00 00 00 00 00 00 00 00 00 00 00 00 00
			00 00 00 00 00 00 00 00 00 00 00 00 00 00 00 00
			00 00 00 00 00 00 00 00 00 00 00 00 00 00 00 00
			00 00 00 00 41 56 45 31 00 00 00 00 0c 00 00 00
			45 4e 4f 4e 01 00 00 00 00 00 00 00 0f 00 00 00
			00 00 00 00 02 00 00 00 00 00 00 00 00 00 00 00
			00 00 00 00 00 00 00 00 02 00 00 00 00 00 00 00
			00 00 00 00 00 00 00 00 00 00 00 00 00 00 00 00
			00 00 00 00 00 00 00 00 00 00 00 00 00 00 00 00
			00 00 00 00 00 00 00 00 00 00 00 00 00 00 00 00
			00 00 00 00 00 00 00 00 00 00 00 00 00 00 00 00
			41 56 44 00 00 00 00 00 0d 00 00 00 45 4e 4f 4e
			01 00 00 00 00 00 00 00 00 00 00 00 00 00 00 00
			02 00 00 00 00 00 00 00 00 00 00 00 00 00 00 00
			00 00 00 00 02 00 00 00 00 00 00 00 00 00 00 00
			00 00 00 00 00 00 00 00 00 00 00 00 00 00 00 00
			00 00 00 00 00 00 00 00 00 00 00 00 00 00 00 00
			00 00 00 00 00 00 00 00 00 00 00 00 00 00 00 00
			00 00 00 00 00 00 00 00 00 00 00 00 4d 53 52 00
			00 00 00 00 0e 00 00 00 45 4e 4f 4e 01 00 00 00
			00 00 00 00 00 00 00 00 00 00 00 00 02 00 00 00
			00 00 00 00 00 00 00 00 00 00 00 00 00 00 00 00
			02 00 00 00 00 00 00 00 00 00 00 00 00 00 00 00
			00 00 00 00 00 00 00 00 00 00 00 00 00 00 00 00
			00 00 00 00 00 00 00 00 00 00 00 00 00 00 00 00
			00 00 00 00 00 00 00 00 00 00 00 00 00 00 00 00
			00 00 00 00 00 00 00 00 4a 50 45 47 00 00 00 00
			10 00 00 00 5f 43 4d 53 00 00 00 00 00 00 00 00
			00 00 00 00 00 00 00 00 00 00 00 00 02 00 00 00
			00 00 00 00 00 00 00 00 00 00 00 00 00 00 00 00
			00 00 00 00 00 00 00 00 00 00 00 00 00 00 00 00
			00 00 00 00 00 00 00 00 00 00 00 00 00 00 00 00
			00 00 00 00 00 00 00 00 00 00 00 00 00 00 00 00
			00 00 00 00 00 00 00 00 00 00 00 00 00 00 00 00
			00 00 00 00 53 4d 43 00 00 00 00 00 16 00 00 00
			45 4e 4f 4e 00 00 00 00 00 00 00 00 00 00 00 00
			00 00 00 00 01 00 00 00 00 00 00 00 00 00 00 00
			00 00 00 00 00 00 00 00 00 00 00 00 00 00 00 00
			00 00 00 00 00 00 00 00 00 00 00 00 00 00 00 00
			00 00 00 00 00 00 00 00 00 00 00 00 00 00 00 00
			00 00 00 00 00 00 00 00 00 00 00 00 00 00 00 00
			00 00 00 00 00 00 00 00 00 00 00 00 00 00 00 00
			53 45 50 00 00 00 00 00 17 00 00 00 45 4e 4f 4e
			01 00 00 00 00 00 00 00 00 00 00 00 00 00 00 00
			01 00 00 00 00 00 00 00 00 00 00 00 00 00 00 00
			00 00 00 00 02 00 00 00 00 00 00 00 00 00 00 00
			00 00 00 00 00 00 00 00 00 00 00 00 00 00 00 00
			00 00 00 00 00 00 00 00 00 00 00 00 00 00 00 00
			00 00 00 00 00 00 00 00 00 00 00 00 00 00 00 00
			00 00 00 00 00 00 00 00 00 00 00 00 41 4e 53 00
			00 00 00 00 18 00 00 00 45 4e 4f 4e 00 00 00 00
			00 00 00 00 00 00 00 00 00 00 00 00 01 00 00 00
			00 00 00 00 00 00 00 00 00 00 00 00 00 00 00 00
			00 00 00 00 00 00 00 00 00 00 00 00 00 00 00 00
			00 00 00 00 00 00 00 00 00 00 00 00 00 00 00 00
			00 00 00 00 00 00 00 00 00 00 00 00 00 00 00 00
			00 00 00 00 00 00 00 00 00 00 00 00 00 00 00 00
			00 00 00 00 00 00 00 00 50 43 49 45 00 00 00 00
			19 00 00 00 45 4e 4f 4e 00 00 00 00 00 00 00 00
			00 00 00 00 00 00 00 00 01 00 00 00 00 00 00 00
			00 00 00 00 00 00 00 00 00 00 00 00 00 00 00 00
			00 00 00 00 00 00 00 00 00 00 00 00 00 00 00 00
			00 00 00 00 00 00 00 00 00 00 00 00 00 00 00 00
			00 00 00 00 00 00 00 00 00 00 00 00 00 00 00 00
			00 00 00 00 00 00 00 00 00 00 00 00 00 00 00 00
			00 00 00 00 53 42 52 00 00 00 00 00 1a 00 00 00
			45 4e 4f 4e 00 00 00 00 00 00 00 00 00 00 00 00
			00 00 00 00 01 00 00 00 00 00 00 00 00 00 00 00
			00 00 00 00 00 00 00 00 00 00 00 00 00 00 00 00
			00 00 00 00 00 00 00 00 00 00 00 00 00 00 00 00
			00 00 00 00 00 00 00 00 00 00 00 00 00 00 00 00
			00 00 00 00 00 00 00 00 00 00 00 00 00 00 00 00
			00 00 00 00 00 00 00 00 00 00 00 00 00 00 00 00
			53 49 4f 00 00 00 00 00 1b 00 00 00 45 4e 4f 4e
			01 00 00 00 00 00 00 00 00 00 00 00 00 00 00 00
			01 00 00 00 00 00 00 00 00 00 00 00 00 00 00 00
			00 00 00 00 02 00 00 00 00 00 00 00 00 00 00 00
			00 00 00 00 00 00 00 00 00 00 00 00 00 00 00 00
			00 00 00 00 00 00 00 00 00 00 00 00 00 00 00 00
			00 00 00 00 00 00 00 00 00 00 00 00 00 00 00 00
			00 00 00 00 00 00 00 00 00 00 00 00 41 54 43 00
			00 00 00 00 1c 00 00 00 45 4e 4f 4e 03 00 00 00
			00 00 00 00 00 00 00 00 00 00 00 00 02 00 00 00
			00 00 00 00 00 00 00 00 00 00 00 00 00 00 00 00
			00 00 00 00 00 00 00 00 00 00 00 00 00 00 00 00
			00 00 00 00 00 00 00 00 00 00 00 00 00 00 00 00
			00 00 00 00 00 00 00 00 00 00 00 00 00 00 00 00
			00 00 00 00 00 00 00 00 00 00 00 00 00 00 00 00
			00 00 00 00 00 00 00 00 50 45 41 52 4c 00 00 00
		];
		mc-dsid-ptd-config = [
			01 00 00 00 00 00 00 00 08 00 00 00 00 00 00 00
			0f 00 00 00 00 00 00 00 11 00 00 00 00 00 00 00
		];
		fast-die-ctrl-ts = [00 00 05 00];
		region-base = [00 00 50 00 03 00 00 00];
		uuid = [
			38 34 41 30 32 36 44 45 2d 38 38 39 36 2d 33 43
			46 34 2d 41 35 42 35 2d 33 36 37 38 37 39 43 38
			46 42 45 45 00
		];
		pre-loaded = [01 00 00 00];
		dram-channel-disable = [00 00 00 00];
	};
};
