// SPDX-License-Identifier: GPL-2.0+ OR MIT
#include "t8142-j813.dts"

/* The bootloader trains port 0. Native Linux owns the DART and endpoint.
 * These ranges and the DART IRQ come from the J813 ADT, not M5 Pro data.
 */
&{/} {
	pcie0: pcie@1cb0000000 {
		compatible = "pci-host-ecam-generic";
		device_type = "pci";
		#address-cells = <3>;
		#size-cells = <2>;
		bus-range = <0 1>;
		reg = <0x1c 0xb0000000 0 0x200000>;
		ranges = <0x43000000 0xb 0xc0000000 0xb 0xc0000000 0 0x20000000>,
		         <0x02000000 0 0x80000000 0xb 0x80000000 0 0x40000000>;
		dma-coherent;
		/* N1's three ADT mapper nodes use stream zero. */
		iommu-map = <0x100 &dart_apcie0 0 1>,
		            <0x101 &dart_apcie0 0 1>,
		            <0x102 &dart_apcie0 0 1>;
	};
};

&{/soc} {
	dart_apcie0: iommu@488000000 {
		compatible = "apple,t8142-dart", "apple,t8110-dart";
		reg = <4 0x88000000 0 0x20000>;
		interrupts = <AIC_IRQ 1463 IRQ_TYPE_LEVEL_HIGH>;
		#iommu-cells = <1>;
	};
};
