// SPDX-License-Identifier: GPL-2.0+ OR MIT
/*
 * Apple MacBook Pro (16-inch, M5 Pro, 2026)
 *
 * target-type: J716s
 *
 * Copyright The Asahi Linux Contributors
 */

/dts-v1/;

#include "t6050.dtsi"
#include "t6050-j714-j716.dtsi"

/ {
	compatible = "apple,j716s", "apple,t6050", "apple,arm-platform";
	model = "Apple MacBook Pro (16-inch, M5 Pro, 2026)";
};
