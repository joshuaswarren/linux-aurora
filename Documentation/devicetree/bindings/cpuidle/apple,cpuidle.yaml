## drivers/pmdomain/apple/Kconfig
```kconfig
# SPDX-License-Identifier: GPL-2.0-only

if ARCH_APPLE || COMPILE_TEST

config APPLE_PMGR_PWRSTATE
	bool "Apple SoC PMGR power state control"
	depends on PM
	select REGMAP
	select MFD_SYSCON
	select PM_GENERIC_DOMAINS
	select RESET_CONTROLLER
	help
	  The PMGR block in Apple SoCs provides high-level power state
	  controls for SoC devices. This driver manages them through the
	  generic power domain framework, and also provides reset support.

config APPLE_PMGR_PSD
	bool "Apple T8152 PSD service slot power domains"
	default ARCH_APPLE
	depends on OF
	depends on PM
	select PM_GENERIC_DOMAINS
	help
	  The M6 (T8152) power state director gates the ATC USB blocks behind a
	  per-port service slot request on top of the PMGR power states. This
	  driver exposes each slot as a power domain whose parents are the PMGR
	  domains, so consumers (the USB DARTs and controllers) power both in order.

config APPLE_PMP_REPORT
	bool "Apple PMP report control"
	depends on OF
	depends on PM
	select PM_GENERIC_DOMAINS

endif
```

## drivers/soc/apple/neo/Kconfig
```kconfig
# SPDX-License-Identifier: GPL-2.0-only

menu "Apple T8140 (J700) platform power and fabric"
	depends on ARCH_APPLE || COMPILE_TEST
	depends on ARM64

config APPLE_T8140_MCC
	tristate "Apple T8140 system-level cache allocation owner"
	default y if ARCH_APPLE
	help
	  Enable system-level-cache allocation at boot on J700 (T8140), as the
	  native AppleT8140MCC driver does (mccEnableCacheMode step 3: AMCC
	  +0x82c = 0 on every plane, only when every plane already reports its
	  ways enabled and powered). Resume re-applies it and reboot, poweroff
	  and kexec run the native quiesce cache flush. On other machines the
	  driver does nothing.

	  Measured on J700: CPU memory latency ~100 -> 30 ns, and GPU depth-1
	  and depth-2 throughput +19-33%. Opt out with neo_mcc.enable=0.

endmenu
```
