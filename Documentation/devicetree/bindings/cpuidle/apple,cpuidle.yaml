## Documentation/devicetree/bindings/mailbox/apple,mailbox.yaml
```yaml
# SPDX-License-Identifier: GPL-2.0 OR BSD-2-Clause
%YAML 1.2
---
$id: http://devicetree.org/schemas/mailbox/apple,mailbox.yaml#
$schema: http://devicetree.org/meta-schemas/core.yaml#

title: Apple Mailbox Controller

maintainers:
  - Hector Martin <marcan@marcan.st>
  - Sven Peter <sven@svenpeter.dev>

description:
  The Apple mailbox consists of two FIFOs used to exchange 64+32 bit
  messages between the main CPU and a co-processor. Multiple instances
  of this mailbox can be found on Apple SoCs.
  One of the two FIFOs is used to send data to a co-processor while the other
  FIFO is used for the other direction.
  Various clients implement different IPC protocols based on these simple
  messages and shared memory buffers.

properties:
  compatible:
    oneOf:
      - description:
          ASC mailboxes are the most common variant found on the M1 used
          for example for the display controller, the system management
          controller and the NVMe coprocessor.
        items:
          - enum:
              - apple,t8103-asc-mailbox
              - apple,t8112-asc-mailbox
              - apple,t8122-asc-mailbox
              - apple,t8140-asc-mailbox
              - apple,t6000-asc-mailbox
              - apple,t6020-asc-mailbox
          - const: apple,asc-mailbox-v4

      - description:
          AOP setup-port mailbox with a separate register layout.
        const: apple,t8140-aop-setup-mailbox

      - description:
          An older ASC mailbox interface found on T2 and A11 that is also
          used for the NVMe coprocessor and the system management
          controller.
        items:
          - const: apple,t8015-asc-mailbox

      - description:
          The second ("setup port") mailbox of the T8140 AOP, through which
          its firmware exchanges the endpoint buffer setup and source-buffer
          binding messages.  Two control words at 0x0/0x4, send registers at
          0x180/0x188 and receive registers at 0x1b0/0x1b8.
        items:
          - const: apple,t8140-aop-setup-mailbox

      - description:
          ASCWrap v6 mailbox transport for the two independent T8140 GPU
          firmware roles. The mailbox-v4 register ABI is embedded at offset
          0x8000 in the first register window. The second register window is
          lifecycle-owned IORVBAR state and is not mailbox MMIO.
        const: apple,t8140-ascwrap-v6

      - description:
          M3 mailboxes are an older variant with a slightly different MMIO
          interface still found on the M1. It is used for the Thunderbolt
          co-processors.
        items:
          - enum:
              - apple,t8103-m3-mailbox
              - apple,t8112-m3-mailbox
              - apple,t6000-m3-mailbox
          - const: apple,m3-mailbox-v2

  reg:
    minItems: 1
    maxItems: 2

  reg-names:
    minItems: 2
    maxItems: 2

  interrupts:
    minItems: 2
    maxItems: 4

  interrupt-names:
    minItems: 2
    maxItems: 4

  iommus:
    maxItems: 1

  apple,dma-range:
    $ref: /schemas/types.yaml#/definitions/uint64-array
    minItems: 2
    maxItems: 2
    description:
      Setup-port DMA allocation window, expressed as a base and nonzero size.
      This identifies host-available slots in the inherited AOP stream root.

  "#mbox-cells":
    const: 0

  power-domains:
    maxItems: 1

allOf:
  - if:
      properties:
        compatible:
          contains:
            const: apple,t8140-aop-setup-mailbox
    then:
      properties:
        interrupts:
          maxItems: 2
        interrupt-names:
          items:
            - const: send-empty
            - const: recv-not-empty
      required:
        - iommus
        - apple,dma-range
    else:
      properties:
        interrupts:
          minItems: 4
        interrupt-names:
          items:
            - const: send-empty
            - const: send-not-empty
            - const: recv-empty
            - const: recv-not-empty
        iommus: false
        apple,dma-range: false

required:
  - compatible
  - reg
  - interrupts
  - interrupt-names
  - "#mbox-cells"

allOf:
  - if:
      properties:
        compatible:
          contains:
            const: apple,t8140-ascwrap-v6
    then:
      properties:
        reg:
          items:
            - description: ASCWrap v6 register window containing the mailbox
            - description: Eight-byte IOP reset-vector-base-address register
        reg-names:
          items:
            - const: wrapper
            - const: iop-vbar
        interrupts:
          items:
            - description: send FIFO is empty interrupt
            - description: receive FIFO is not empty interrupt
        interrupt-names:
          items:
            - const: send-empty
            - const: recv-not-empty
      required:
        - reg-names
        - apple,firmware-role
    else:
      properties:
        reg:
          maxItems: 1
        reg-names: false
        interrupts:
          items:
            - description: send FIFO is empty interrupt
            - description: send FIFO is not empty interrupt
            - description: receive FIFO is empty interrupt
            - description: receive FIFO is not empty interrupt
        interrupt-names:
          items:
            - const: send-empty
            - const: send-not-empty
            - const: recv-empty
            - const: recv-not-empty
        apple,firmware-role: false

additionalProperties: false

examples:
  - |
    mailbox@77408000 {
        compatible = "apple,t8103-asc-mailbox", "apple,asc-mailbox-v4";
        reg = <0x77408000 0x4000>;
        interrupts = <1 583 4>, <1 584 4>, <1 585 4>, <1 586 4>;
        interrupt-names = "send-empty", "send-not-empty",
                          "recv-empty", "recv-not-empty";
        #mbox-cells = <0>;
    };

  - |
    #include <dt-bindings/interrupt-controller/apple-aic.h>
    #include <dt-bindings/interrupt-controller/irq.h>

    soc {
        #address-cells = <2>;
        #size-cells = <2>;

        gfx_asc: mailbox@482600000 {
            compatible = "apple,t8140-ascwrap-v6";
            reg = <0x4 0x82600000 0x0 0x88000>,
                  <0x4 0x82050000 0x0 0x8>;
            reg-names = "wrapper", "iop-vbar";
            interrupts = <AIC_IRQ 993 IRQ_TYPE_LEVEL_HIGH>,
                         <AIC_IRQ 996 IRQ_TYPE_LEVEL_HIGH>;
            interrupt-names = "send-empty", "recv-not-empty";
            apple,firmware-role = "GFX";
            #mbox-cells = <0>;
        };

        gfx1_asc: mailbox@482e00000 {
            compatible = "apple,t8140-ascwrap-v6";
            reg = <0x4 0x82e00000 0x0 0x88000>,
                  <0x4 0x82850000 0x0 0x8>;
            reg-names = "wrapper", "iop-vbar";
            interrupts = <AIC_IRQ 997 IRQ_TYPE_LEVEL_HIGH>,
                         <AIC_IRQ 1000 IRQ_TYPE_LEVEL_HIGH>;
            interrupt-names = "send-empty", "recv-not-empty";
            apple,firmware-role = "GFX1";
            #mbox-cells = <0>;
        };
    };
```

## Documentation/devicetree/bindings/power/apple,pmp-report.yaml
```yaml
# SPDX-License-Identifier: (GPL-2.0-only OR BSD-2-Clause)
%YAML 1.2
---
$id: http://devicetree.org/schemas/power/apple,pmp-report.yaml#
$schema: http://devicetree.org/meta-schemas/core.yaml#

title: Apple SoC PMP Report Region

maintainers:
  - Ryan Murray <ryan@aurorasilicon.org>

description:
  The Power Management Processor (PMP) shares a register region with the
  application processors. The read window is an array of 16-byte entries in
  which the PMP publishes its status and control values, for example the
  die-temperature effort of each CPU cluster (see apple,cluster-cpufreq.yaml),
  and the application processors report the power state of the blocks the
  PMP accounts for in the update window. Child nodes describe those blocks;
  each one is a power domain whose state is reported to the PMP.

properties:
  compatible:
    enum:
      - apple,t6000-pmp-v2-report
      - apple,t6020-pmp-v2-report
      - apple,t8112-pmp-v2-report
      - apple,t8140-pmp-v2-report

  reg:
    maxItems: 1

  power-domains:
    maxItems: 1

  '#address-cells':
    const: 1

  '#size-cells':
    const: 0

patternProperties:
  "^report@[0-9a-f]+$":
    type: object
    description: A block whose power state is reported to the PMP.

    properties:
      compatible:
        oneOf:
          - const: apple,t6000-pmp-v2-report-entry
          - items:
              - enum:
                  - apple,t6020-pmp-v2-report-entry
                  - apple,t8112-pmp-v2-report-entry
              - const: apple,t6000-pmp-v2-report-entry

      reg:
        maxItems: 1
        description: Index of the block in the report.

      label:
        description: Name of the power domain.

      '#power-domain-cells':
        const: 0

      power-domains:
        maxItems: 1

      apple,always-on:
        type: boolean
        description: The block must be reported as powered at all times.

    required:
      - compatible
      - reg
      - label
      - '#power-domain-cells'

    additionalProperties: false

required:
  - compatible
  - reg

additionalProperties: false

examples:
  - |
    soc {
      #address-cells = <2>;
      #size-cells = <2>;

      pmp-report@23b3c0000 {
        compatible = "apple,t8112-pmp-v2-report";
        reg = <0x2 0x3b3c0000 0x0 0x20000>;
        power-domains = <&ps_pms_sram>;
        #address-cells = <1>;
        #size-cells = <0>;

        report@4 {
          compatible = "apple,t8112-pmp-v2-report-entry",
                       "apple,t6000-pmp-v2-report-entry";
          reg = <0x4>;
          label = "pmp-gfx";
          #power-domain-cells = <0>;
          power-domains = <&ps_gfx>;
        };
      };
    };
```

## Documentation/devicetree/bindings/power/apple,t8152-psd.yaml
```yaml
# SPDX-License-Identifier: (GPL-2.0-only OR BSD-2-Clause)
%YAML 1.2
---
$id: http://devicetree.org/schemas/power/apple,t8152-psd.yaml#
$schema: http://devicetree.org/meta-schemas/core.yaml#

title: Apple T8152 PSD service slot power domain

maintainers:
  - Joshua Warren <joshua@joshuawarren.com>

allOf:
  - $ref: power-domain.yaml#

description: |
  The T8152 (M6) power state director (PSD) gates some blocks, among them the
  ATC USB controllers and their DARTs, behind a per-port service slot. Each
  slot has a 0x100 byte register window at the PSD base plus (slot << 8) with
  the status (0x80), request (0x90), diagnostic (0xa0) and valid (0xbc)
  registers. A consumer must power the parent PMGR domains (for ATC USB:
  ATCn_USB_AON and ATCn_USB) first, then request state 0 (P0 RUN_MAX) and wait
  for the acknowledge. This node models that as a power domain: the PMGR
  domains are its parents (power-domains), powering it on writes the request.
  Power-off requests state 6 (P6 RAIL_GATE).

  A "apple,t8152-psd-group" node covers several slots that are brought up
  together (the GPU: slots 3, 82 and 81): one reg window per slot, requested
  in reg order with the active state given by apple,psd-states, and put back
  to state 6 in reverse order.

properties:
  compatible:
    enum:
      - apple,t8152-psd
      - apple,t8152-psd-group

  reg:
    minItems: 1
    maxItems: 3

  "#power-domain-cells":
    const: 0

  power-domains:
    description:
      Parent PMGR power domains, powered before the slot request. Absent when
      the block has no PMGR power state (the GPU slots).
    minItems: 1
    maxItems: 4

  label:
    description: Name of the power domain.

  apple,psd-states:
    $ref: /schemas/types.yaml#/definitions/uint32-array
    minItems: 1
    maxItems: 3
    description:
      Active PSD state requested for each reg window, in reg order (default
      0, P0 RUN_MAX). Each value is 0 to 5.

  apple,psd-timeout-ms:
    description: Acknowledge timeout in milliseconds (default 1000).

required:
  - compatible
  - reg
  - "#power-domain-cells"

unevaluatedProperties: false

examples:
  - |
    soc {
      #address-cells = <2>;
      #size-cells = <2>;

      ps_usb_aon: power-controller-aon {
        #power-domain-cells = <0>;
      };

      ps_usb: power-controller-usb {
        #power-domain-cells = <0>;
      };

      power-controller@303a14700 {
        compatible = "apple,t8152-psd";
        reg = <0x3 0x03a14700 0x0 0x100>;
        #power-domain-cells = <0>;
        power-domains = <&ps_usb_aon>, <&ps_usb>;
        label = "psd_atc0_usb";
      };
    };
  - |
    soc {
      #address-cells = <2>;
      #size-cells = <2>;

      power-controller@303a10300 {
        compatible = "apple,t8152-psd-group";
        reg = <0x3 0x03a10300 0x0 0x100>,
              <0x3 0x03a15200 0x0 0x100>,
              <0x3 0x03a15100 0x0 0x100>;
        apple,psd-states = <0 2 2>;
        #power-domain-cells = <0>;
        label = "psd_gpu";
      };
    };
```

## Documentation/devicetree/bindings/rtc/apple,smc-rtc.yaml
```yaml
# SPDX-License-Identifier: (GPL-2.0-only OR BSD-2-Clause)
%YAML 1.2
---
$id: http://devicetree.org/schemas/rtc/apple,smc-rtc.yaml#
$schema: http://devicetree.org/meta-schemas/core.yaml#

title: Apple SMC RTC

description:
  Apple Silicon Macs (M1, etc.) have an RTC that is part of the PMU IC,
  but most of the PMU functionality is abstracted out by the SMC.
  An additional RTC offset stored inside NVMEM is required to compute
  the current date/time.

maintainers:
  - Sven Peter <sven@kernel.org>

properties:
  compatible:
    const: apple,smc-rtc

  nvmem-cells:
    items:
      - description:
          RTC offset. 48bit, specified in 32768 (2^15) Hz clock ticks, unless
          apple,rtc-offset-seconds is set, in which case it is a 64bit
          little-endian count of whole seconds.

  nvmem-cell-names:
    items:
      - const: rtc_offset

  apple,rtc-offset-seconds:
    type: boolean
    description:
      The PMU keeps the RTC offset as whole seconds in its legacy scratchpad
      (t8140 "baku" PMU and later) rather than as 32768 Hz ticks. The current
      time is then the counter's integer seconds plus the offset.

required:
  - compatible
  - nvmem-cells
  - nvmem-cell-names

additionalProperties: false
```
