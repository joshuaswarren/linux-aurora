## Documentation/devicetree/bindings/cpuidle/apple,cpuidle.yaml
```yaml
# SPDX-License-Identifier: (GPL-2.0-only OR BSD-2-Clause)
%YAML 1.2
---
$id: http://devicetree.org/schemas/cpuidle/apple,cpuidle.yaml#
$schema: http://devicetree.org/meta-schemas/core.yaml#

title: Apple T8140 CPU idle

maintainers:
  - Ryan Murray <ryan@aurorasilicon.org>

description: |
  The Apple CPU idle driver uses a core system register to request CPU power
  down. A T8140 board opts in through this node. Software must preserve CPU
  state across entry and restore it after an interrupt.

properties:
  compatible:
    const: apple,t8140-cpuidle

required:
  - compatible

additionalProperties: false

examples:
  - |
    cpuidle {
        compatible = "apple,t8140-cpuidle";
    };
```

## Documentation/devicetree/bindings/gpu/apple,agx.yaml
```yaml
# SPDX-License-Identifier: (GPL-2.0 OR BSD-2-Clause)
%YAML 1.2
---
$id: http://devicetree.org/schemas/gpu/apple,agx.yaml#
$schema: http://devicetree.org/meta-schemas/core.yaml#

title: Apple SoC GPU

maintainers:
  - Sasha Finkelstein <k@chaosmail.tech>

properties:
  compatible:
    oneOf:
      - enum:
          - apple,agx-g13g
          - apple,agx-g13s
          - apple,agx-g14g
          - apple,agx-g14s
      - items:
          - enum:
              - apple,agx-g13c
              - apple,agx-g13d
          - const: apple,agx-g13s
      - items:
          - enum:
              - apple,agx-g14c
              - apple,agx-g14d
          - const: apple,agx-g14s
      - description:
          T8140 (A18 Pro) G17P GPU. Unlike the single-coprocessor AGX2
          parts above, it is driven by two independent ASC coprocessors
          carrying the GFX and GFX1 firmware roles, each with its own
          ASCWrap v6 mailbox provider. The second compatible entry is the
          literal Apple Device Tree identifier for this node.
        items:
          - const: apple,agx-t8140
          - const: gpu,t8140

  reg:
    minItems: 2
    items:
      - description: GPU coprocessor control registers
      - description: GPU block MMIO registers
      - description:
          Control registers of the secondary GPU coprocessor, on SoCs
          driven by two independent GPU coprocessors (T8140)

  reg-names:
    minItems: 2
    items:
      - const: asc
      - const: sgx
      - const: asc1

  power-domains:
    maxItems: 1

  mboxes:
    minItems: 1
    maxItems: 2

  memory-region:
    minItems: 3
    items:
      - description: Region containing GPU MMU TTBs
      - description: Region containing GPU MMU page tables
      - description:
          Region containing a shared handoff structure for VM
          management coordination
      - description: Calibration blob. Mostly power-related configuration
      - description: Calibration blob. Mostly GPU-related configuration
      - description: Shared global variables with GPU firmware

  memory-region-names:
    minItems: 3
    items:
      - const: ttbs
      - const: pagetables
      - const: handoff
      - const: hw-cal-a
      - const: hw-cal-b
      - const: globals

  operating-points-v2: true

  apple,firmware-abi:
    $ref: /schemas/types.yaml#/definitions/uint32-array
    minItems: 3
    description:
      macOS version the current firmware is paired with, used to pick
      the version of firmware ABI to be used.
      Bootloader will overwrite this

required:
  - compatible
  - reg
  - mboxes
  - memory-region

allOf:
  - if:
      properties:
        compatible:
          contains:
            const: apple,agx-t8140
    then:
      properties:
        reg:
          minItems: 2
          maxItems: 2
          items:
            - description:
                Topology alias of the primary ASCWrap v6 window. The
                apple,t8140-ascwrap-v6 mailbox provider is the sole mapping
                and CPU-lifecycle owner; the GPU consumer must not map this
                alias or write CPU control directly.
            - description: GPU block MMIO registers
        reg-names:
          minItems: 2
          maxItems: 2
        mboxes:
          items:
            - description:
                Mailbox of the GFX (primary) firmware role, an
                apple,t8140-ascwrap-v6 provider
            - description:
                Mailbox of the GFX1 (scheduler peer) firmware role, an
                apple,t8140-ascwrap-v6 provider
        memory-region:
          maxItems: 3
        memory-region-names:
          maxItems: 3
        apple,firmware-abi: false
      required:
        - reg-names
        - operating-points-v2
    else:
      properties:
        reg:
          maxItems: 2
        reg-names:
          maxItems: 2
        mboxes:
          maxItems: 1
        memory-region:
          minItems: 6
        memory-region-names:
          minItems: 6
      required:
        - apple,firmware-abi

additionalProperties: false

examples:
  - |
    gpu@6400000 {
        compatible = "apple,agx-g13g";
        reg = <0x6400000 0x40000>,
              <0x4000000 0x1000000>;
        reg-names = "asc", "sgx";
        mboxes = <&agx_mbox>;
        power-domains = <&ps_gfx>;
        memory-region = <&uat_ttbs>, <&uat_pagetables>, <&uat_handoff>,
                        <&gpu_hw_cal_a>, <&gpu_hw_cal_b>, <&gpu_globals>;
        memory-region-names = "ttbs", "pagetables", "handoff",
                              "hw-cal-a", "hw-cal-b", "globals";

        apple,firmware-abi = <0 0 0>;
    };

  - |
    soc {
        #address-cells = <2>;
        #size-cells = <2>;

        gpu@482600000 {
            compatible = "apple,agx-t8140", "gpu,t8140";
            reg = <0x4 0x82600000 0x0 0x88000>,
                  <0x4 0x80000000 0x0 0x4000000>;
            reg-names = "asc", "sgx";
            mboxes = <&gfx_asc>, <&gfx1_asc>;
            power-domains = <&ps_gfx>;
            memory-region = <&uat_ttbs>, <&uat_pagetables>, <&uat_handoff>;
            memory-region-names = "ttbs", "pagetables", "handoff";
            operating-points-v2 = <&gpu_opp>;
        };
    };
...
```

## Documentation/devicetree/bindings/iommu/apple,dart.yaml
```yaml
# SPDX-License-Identifier: (GPL-2.0 OR BSD-2-Clause)
%YAML 1.2
---
$id: http://devicetree.org/schemas/iommu/apple,dart.yaml#
$schema: http://devicetree.org/meta-schemas/core.yaml#

title: Apple DART IOMMU

maintainers:
  - Sven Peter <sven@svenpeter.dev>

description: |+
  Apple SoCs may contain an implementation of their Device Address
  Resolution Table which provides a mandatory layer of address
  translations for various masters.

  Depending on the generation, a DART instance can handle up to 256 streams
  with individual pagetables and page-level read/write protection flags.

  This DART IOMMU also raises interrupts in response to various
  fault conditions.

properties:
  compatible:
    oneOf:
      - enum:
          - apple,t8103-dart
          - apple,t8103-usb4-dart
          - apple,t8110-dart
          - apple,t6000-dart
      - items:
          - enum:
              - apple,t6020-dart
              - apple,t8122-dart
              - apple,t8140-dart
          - const: apple,t8110-dart

  reg:
    maxItems: 1

  interrupts:
    maxItems: 1

  clocks:
    description:
      Reference to the gate clock phandle if required for this IOMMU.
      Optional since not all IOMMUs are attached to a clock gate.

  '#iommu-cells':
    const: 1
    description:
      Has to be one. The single cell describes the stream id emitted by
      a master to the IOMMU.

  power-domains:
    maxItems: 1

  apple,dma-range:
    $ref: /schemas/types.yaml#/definitions/uint64-array
    minItems: 2
    maxItems: 2
    description:
      DMA allocation aperture expressed as a base followed by its size. High
      aperture bits may be a firmware-visible alias which the DART driver
      removes before programming a narrower hardware page table.

  apple,remap-streams:
    $ref: /schemas/types.yaml#/definitions/uint32-matrix
    items:
      items:
        - description: source stream id
        - description: target stream id
    description:
      t8110 DARTs can fold a stream onto another one so that it is translated,
      filtered and TLB-tracked exactly as the target (the ADT "remap" list).
      Each pair remaps the source stream onto the target stream; the source
      keeps no translation table of its own.

required:
  - compatible
  - reg
  - '#iommu-cells'
  - interrupts

additionalProperties: false

examples:
  - |+
    dart1: iommu@82f80000 {
      compatible = "apple,t8103-dart";
      reg = <0x82f80000 0x4000>;
      interrupts = <1 781 4>;
      #iommu-cells = <1>;
    };

    master1 {
      iommus = <&dart1 0>;
    };

  - |+
    dart2a: iommu@82f00000 {
      compatible = "apple,t8103-dart";
      reg = <0x82f00000 0x4000>;
      interrupts = <1 781 4>;
      #iommu-cells = <1>;
    };
    dart2b: iommu@82f80000 {
      compatible = "apple,t8103-dart";
      reg = <0x82f80000 0x4000>;
      interrupts = <1 781 4>;
      #iommu-cells = <1>;
    };

    master2 {
      iommus = <&dart2a 0>, <&dart2b 1>;
    };
```
