## Documentation/devicetree/bindings/soc/apple/apple,pmp.yaml
```yaml
# SPDX-License-Identifier: (GPL-2.0-only OR BSD-2-Clause)
%YAML 1.2
---
$id: http://devicetree.org/schemas/soc/apple/apple,pmp.yaml#
$schema: http://devicetree.org/meta-schemas/core.yaml#

title: Apple SoC Power Management Processor

maintainers:
  - Ryan Murray <ryan@aurorasilicon.org>

description:
  The Power Management Processor (PMP) is an RTKit coprocessor that manages
  SoC power and performance. Its firmware is loaded by the bootloader, which
  also adds the board and firmware configuration properties below and enables
  the node. The application processor starts the firmware and serves its
  requests for memory and configuration values.

properties:
  compatible:
    oneOf:
      - const: apple,t6000-pmp-v2
      - items:
          - enum:
              - apple,t6020-pmp-v2
              - apple,t8112-pmp-v2
              - apple,t8140-pmp-v2
          - const: apple,t6000-pmp-v2

  reg:
    items:
      - description: PMP memory holding the firmware boot arguments
      - description: ASC processor control registers

  reg-names:
    items:
      - const: pmp
      - const: asc

  mboxes:
    maxItems: 1

  mbox-names:
    const: mbox

  iommus:
    maxItems: 1

  power-domains:
    maxItems: 1

  apple,board-id:
    $ref: /schemas/types.yaml#/definitions/uint32
    description: Board identifier, added by the bootloader.

  apple,dram-vendor-id:
    $ref: /schemas/types.yaml#/definitions/uint32
    description: DRAM vendor identifier, added by the bootloader.

  apple,dram-capacity:
    $ref: /schemas/types.yaml#/definitions/uint32
    description:
      DRAM capacity, added by the bootloader when the firmware configuration
      provides it.

  apple,pio-ranges:
    $ref: /schemas/types.yaml#/definitions/uint64-matrix
    items:
      items:
        - description: Physical base address of the register range
        - description: Size of the register range
    description:
      Register ranges the firmware accesses through the DART. They are mapped
      and listed for the firmware when it asks for them.

patternProperties:
  "^apple,tunable-.+$":
    $ref: /schemas/types.yaml#/definitions/uint8-array
    description:
      Firmware configuration values, copied by the bootloader from the Apple
      device tree and handed to the firmware when it requests them by name.

required:
  - compatible
  - reg
  - reg-names
  - mboxes
  - mbox-names
  - iommus
  - power-domains

additionalProperties: false

examples:
  - |
    soc {
      #address-cells = <2>;
      #size-cells = <2>;

      pmp@300500000 {
        compatible = "apple,t8140-pmp-v2", "apple,t6000-pmp-v2";
        reg = <0x3 0x00500000 0x0 0xa0000>,
              <0x3 0x00e00000 0x0 0x4000>;
        reg-names = "pmp", "asc";
        mboxes = <&pmp_mbox>;
        mbox-names = "mbox";
        iommus = <&pmp_dart 0>;
        power-domains = <&ps_pmp>;
      };
    };
```

## Documentation/devicetree/bindings/sound/apple,t8140-aop-audio.yaml
```yaml
# SPDX-License-Identifier: (GPL-2.0-only OR BSD-2-Clause)
%YAML 1.2
---
$id: http://devicetree.org/schemas/sound/apple,t8140-aop-audio.yaml#
$schema: http://devicetree.org/meta-schemas/core.yaml#

title: Apple T8140 AOP audio

maintainers:
  - Ryan Murray <ryan@murraytraining.com.au>

description: |
  The Always-On Processor on Apple T8140 SoCs owns the machine's low-power
  audio paths. This node is a child of the AOP node and describes the DMA
  channels and power domains the host needs in order to drive them, namely
  the internal speaker, the 3.5 mm headset jack in both directions, a serial
  monitor tap on the speaker output, and the high-quality microphone array.

  Audio data moves over ADMAC channels while the corresponding AOP service is
  powered. The AOP itself is reached over EPIC and needs no description here.

properties:
  compatible:
    const: apple,t8140-aop-audio

  dmas:
    maxItems: 5

  dma-names:
    items:
      - const: spkr
      - const: cout
      - const: cin
      - const: spkr-tap
      - const: hpai

  power-domains:
    maxItems: 5

  power-domain-names:
    items:
      - const: tx0
      - const: mca
      - const: mca1
      - const: mca0
      - const: rx0

  iommus:
    maxItems: 1

  apple,dma-range:
    $ref: /schemas/types.yaml#/definitions/uint64-array
    minItems: 2
    maxItems: 2
    description: |
      IOVA window the AOP may use for this device's audio buffers, expressed
      as a base followed by its size.

  "#sound-dai-cells":
    const: 1

  apple,chassis-name:
    $ref: /schemas/types.yaml#/definitions/string
    description:
      Chassis identifier used to name the sound card, matching the
      apple,aop-audio convention.

  apple,machine-kind:
    $ref: /schemas/types.yaml#/definitions/string
    description:
      Human-readable machine name used in the sound card's description.

required:
  - compatible
  - dmas
  - dma-names
  - power-domains
  - power-domain-names
  - "#sound-dai-cells"
  - apple,chassis-name
  - apple,machine-kind

additionalProperties: false

examples:
  - |
    aop {
        audio {
            compatible = "apple,t8140-aop-audio";
            iommus = <&aop_dart 9>;
            apple,dma-range = <0x100 0x40000000 0x0 0xffff0000>;
            dmas = <&admac_leap_ns 0>, <&admac_base_ns 4>,
                   <&admac_base_ns 5>, <&admac_base_ns 3>,
                   <&admac_leap_s 1>;
            dma-names = "spkr", "cout", "cin", "spkr-tap", "hpai";
            power-domains = <&ps_audio_leap_tx0>, <&ps_audio_leap_mca>,
                            <&ps_audio_mca1_m>, <&ps_audio_mca0_m>,
                            <&ps_audio_leap_rx0>;
            power-domain-names = "tx0", "mca", "mca1", "mca0", "rx0";
            #sound-dai-cells = <1>;
            apple,chassis-name = "J700";
            apple,machine-kind = "MacBook Neo";
        };
    };
```

## Documentation/devicetree/bindings/usb/apple,dwc3.yaml
```yaml
# SPDX-License-Identifier: (GPL-2.0-only OR BSD-2-Clause)
%YAML 1.2
---
$id: http://devicetree.org/schemas/usb/apple,dwc3.yaml#
$schema: http://devicetree.org/meta-schemas/core.yaml#

title: Apple Silicon DWC3 USB controller

maintainers:
  - Sven Peter <sven@kernel.org>

description:
  Apple Silicon SoCs use a Synopsys DesignWare DWC3 based controller for each of
  their Type-C ports.

allOf:
  - $ref: snps,dwc3-common.yaml#
  - if:
      properties:
        compatible:
          contains:
            const: apple,t6050-dwc3
    then:
      properties:
        reg:
          minItems: 5
          maxItems: 5
        reg-names:
          items:
            - const: dwc3-core
            - const: dwc3-apple
            - const: drd-cfg
            - const: drd-bulk
            - const: drd-ausbc
      required:
        - apple,tunable-bulk-default
        - apple,tunable-gbl-default
        - apple,tunable-gbl-host
        - apple,tunable-cio-default
        - apple,tunable-debug-default
        - apple,tunable-cfg-host
        - apple,tunable-link-default
        - apple,tunable-ausbc-default
    else:
      properties:
        reg:
          minItems: 2
          maxItems: 2
        reg-names:
          items:
            - const: dwc3-core
            - const: dwc3-apple

properties:
  compatible:
    oneOf:
      - items:
          - enum:
              - apple,t6000-dwc3
              - apple,t6020-dwc3
              - apple,t8112-dwc3
              - apple,t8140-dwc3
              - apple,t8142-dwc3
          - const: apple,t8103-dwc3
      - const: apple,t6050-dwc3
      - const: apple,t8103-dwc3

  reg:
    minItems: 2
    maxItems: 5

  reg-names:
    minItems: 2
    maxItems: 5

  interrupts:
    maxItems: 1

  iommus:
    maxItems: 2

  resets:
    maxItems: 1

  power-domains:
    maxItems: 1

  apple,tunable-bulk-default:
    $ref: /schemas/types.yaml#/definitions/uint32-array
    description: Producer-supplied offset, mask and value register tuples

  apple,tunable-gbl-default:
    $ref: /schemas/types.yaml#/definitions/uint32-array
    description: Producer-supplied offset, mask and value register tuples

  apple,tunable-gbl-host:
    $ref: /schemas/types.yaml#/definitions/uint32-array
    description: Producer-supplied offset, mask and value register tuples

  apple,tunable-cio-default:
    $ref: /schemas/types.yaml#/definitions/uint32-array
    description: Producer-supplied offset, mask and value register tuples

  apple,tunable-debug-default:
    $ref: /schemas/types.yaml#/definitions/uint32-array
    description: Producer-supplied offset, mask and value register tuples

  apple,tunable-cfg-host:
    $ref: /schemas/types.yaml#/definitions/uint32-array
    description: Producer-supplied offset, mask and value register tuples

  apple,tunable-link-default:
    $ref: /schemas/types.yaml#/definitions/uint32-array
    description: Producer-supplied offset, mask and value register tuples

  apple,tunable-ausbc-default:
    $ref: /schemas/types.yaml#/definitions/uint32-array
    description: Producer-supplied offset, mask and value register tuples

required:
  - compatible
  - reg
  - reg-names
  - interrupts
  - iommus
  - resets
  - power-domains
  - usb-role-switch

unevaluatedProperties: false

examples:
  - |
    #include <dt-bindings/interrupt-controller/apple-aic.h>
    #include <dt-bindings/interrupt-controller/irq.h>

    usb@82280000 {
      compatible = "apple,t8103-dwc3";
      reg = <0x82280000 0xcd00>, <0x8228cd00 0x3200>;
      reg-names = "dwc3-core", "dwc3-apple";
      interrupts = <AIC_IRQ 777 IRQ_TYPE_LEVEL_HIGH>;
      iommus = <&dwc3_0_dart_0 0>, <&dwc3_0_dart_1 1>;

      power-domains = <&ps_atc0_usb>;
      resets = <&atcphy0>;

      usb-role-switch;
    };
```

## drivers/gpu/drm/apple/Kconfig
```kconfig
# SPDX-License-Identifier: GPL-2.0-only OR MIT
config DRM_APPLE
	tristate "DRM Support for Apple display controllers"
	depends on DRM && OF && ARM64
	depends on ARCH_APPLE || COMPILE_TEST
	depends on APPLE_RTKIT
	depends on OF_ADDRESS
	select APPLE_PMP_REPORT
	select DRM_CLIENT_SELECTION
	select DRM_KMS_HELPER
	select DRM_KMS_DMA_HELPER
	select DRM_GEM_DMA_HELPER
	select VIDEOMODE_HELPERS
	depends on BACKLIGHT_CLASS_DEVICE
	select MULTIPLEXER
	help
	  Say Y if you have an Apple Silicon chipset.

config DRM_APPLE_AUDIO
	bool "DisplayPort/HDMI Audio support"
	default y
	depends on DRM_APPLE
	depends on SND
	select SND_PCM
	select SND_DMAENGINE_PCM

config DRM_APPLE_DEBUG
	bool "Enable additional driver debugging"
	depends on DRM_APPLE
	depends on EXPERT # only for developers

config DRM_APPLE_KUNIT_TEST
	tristate "KUnit tests for the Apple display driver" if !KUNIT_ALL_TESTS
	depends on DRM_APPLE && KUNIT
	default KUNIT_ALL_TESTS
	help
	  Build focused unit tests for Apple display lifecycle helpers and DCPLink
	  message encoders. The tests do not access display hardware. If in doubt,
	  say "N".
```

## drivers/hid/dockchannel-hid/Kconfig
```kconfig
# SPDX-License-Identifier: GPL-2.0-only OR MIT
menu "DockChannel HID support"
	depends on APPLE_DOCKCHANNEL

config HID_DOCKCHANNEL
	tristate "HID over DockChannel transport layer for Apple Silicon SoCs"
	depends on APPLE_DOCKCHANNEL && INPUT && OF && HID
	help
	  Say Y here if you use an M2 or later Apple Silicon based laptop.
	  The keyboard and touchpad are HID based devices connected via the
	  proprietary DockChannel interface.

config HID_DOCKCHANNEL_KUNIT_TEST
	tristate "KUnit tests for DockChannel HID" if !KUNIT_ALL_TESTS
	depends on KUNIT && HID_DOCKCHANNEL
	default KUNIT_ALL_TESTS
	help
	  Build tests for hardware-independent DockChannel HID protocol helpers.
	  These verify command serialization without requiring Apple hardware.
	  They cover both plain and two-phase power transitions.
	  If in doubt, say N.

endmenu
```

## drivers/net/wireless/mediatek/mt76/mt7921/Kconfig
```kconfig
# SPDX-License-Identifier: BSD-3-Clause-Clear
config MT7921_COMMON
	tristate
	select MT792x_LIB
	select WANT_DEV_COREDUMP

config MT7921E
	tristate "MediaTek MT7921E (PCIe) support"
	select MT7921_COMMON
	depends on MAC80211
	depends on PCI
	help
	  This adds support for MT7921E 802.11ax 2x2:2SS wireless devices.

	  To compile this driver as a module, choose M here.

config MT7921_J700_MCU_LAB
	bool "J700 MT7932 MCU conformance checkpoint"
	depends on MT7921E = y || MT7921E = MT7921_COMMON
	default n
	help
	  Development-only misc-device bridge for measured J700 firmware command
	  conformance. The kernel retains PCIe, WFDMA, TXD, sequence, IRQ, RX and
	  reset ownership. It can stop early probe while an external conformance
	  executor supplies measured firmware commands. Production kernels should
	  leave this disabled.

config MT7921S
	tristate "MediaTek MT7921S (SDIO) support"
	select MT76_SDIO
	select MT7921_COMMON
	depends on MAC80211
	depends on MMC
	help
	  This adds support for MT7921S 802.11ax 2x2:2SS wireless devices.

	  To compile this driver as a module, choose M here.

config MT7921U
	tristate "MediaTek MT7921U (USB) support"
	select MT792x_USB
	select MT7921_COMMON
	depends on MAC80211
	depends on USB
	help
	  This adds support for MT7921U 802.11ax 2x2:2SS wireless devices.

	  To compile this driver as a module, choose M here.
```

## drivers/net/wireless/mediatek/mt7932/Kconfig
```kconfig
# SPDX-License-Identifier: GPL-2.0-only
config MT7932_FULLMAC
	bool "Experimental J700 MT7932 fullmac wireless support"
	depends on PCI && OF && ARM64 && IOMMU_DMA
	select FW_LOADER
	select CFG80211
	help
	  Native support for the built-in J700 Wi-Fi endpoint: managed
	  WPA2-CCMP station operation on 2.4 GHz and non-DFS 5 GHz at 20 MHz.
	  The private max_bw_mhz=40/80 experiment enables wider 5 GHz channels.
	  Its native ABI research is tainted and its RF behavior is unqualified.
	  Requires original firmware, own calibration and original-derived
	  country policy packages in addition to the cfg80211 regulatory database.
	  Requires a trained retained PCI link and a translated SID1 DMA domain.
	  Firmware, runtime DMA and calibration negotiation start automatically;
	  cfg80211 and userspace select the country and network. No test boot
	  parameters are required for ordinary station operation.
	  No automatic recovery or unbind is provided while DMA teardown is
	  unqualified. Other MediaTek devices and other machines are not matched.

config MT7932_RATE_KUNIT_TEST
	tristate "MT7932 RX rate decoder tests" if !KUNIT_ALL_TESTS
	depends on KUNIT && MT7932_FULLMAC
	default KUNIT_ALL_TESTS
	help
	  Test rate decoding and RX descriptor bounds without radio hardware.
	  Covers legacy, HT, VHT and HE SU rates, invalid vectors and missing
	  or truncated descriptor groups. This does not validate the firmware's
	  live RX vector layout or replace an AP-side rate comparison.

config MT7932_BW_KUNIT_TEST
	bool "MT7932 experimental bandwidth tests" if !KUNIT_ALL_TESTS
	depends on KUNIT=y && MT7932_FULLMAC
	default KUNIT_ALL_TESTS
	help
	  Test native width encodings, regulatory constituent-channel gating,
	  fallback capabilities and synthetic calibration plans without hardware.

config MT7932_LINK_KUNIT_TEST
	bool "MT7932 association event tests" if !KUNIT_ALL_TESTS
	depends on KUNIT=y && MT7932_FULLMAC
	default KUNIT_ALL_TESTS
	help
	  Test repeated association starts, calibration ownership and completion
	  wakeups using synthetic firmware events, without radio hardware.
	  Covers terminal failures and rejects overlapping calibration requests.
	  These tests do not replace cold-boot association qualification.
```
